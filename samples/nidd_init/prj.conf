## CMakeLists.txt
```
cmake_minimum_required(VERSION 3.20.0)

# The sample drives lte_lc itself and brings up no IP, so it takes neither the
# shared IP bring-up nor its board fragments.
set(SAMPLE_NETWORK OFF)
include(${CMAKE_CURRENT_SOURCE_DIR}/../common/app.cmake)

if(NOT board_target MATCHES "^circuitdojo_feather/nrf9160/ns$")
  message(FATAL_ERROR
    "nidd_init builds for circuitdojo_feather/nrf9160/ns only: Verizon serves NIDD to modules "
    "it supports, and the nRF9151 is not one")
endif()

find_package(Zephyr REQUIRED HINTS $ENV{ZEPHYR_BASE})
project(nidd_init)

target_sources(app PRIVATE src/main.c src/shadow.c)
```

## Kconfig.sysbuild
```
rsource "../Kconfig.sysbuild.signing"

# A Feather has nothing at address 0 without MCUboot.
choice BOOTLOADER
	default BOOTLOADER_MCUBOOT
endchoice

source "share/sysbuild/Kconfig"
```

## prj.conf
```kconfig
# The Pigeon client library over the carrier's Non-IP Data Delivery. The
# endpoint names the Non-IP APN and is the same for every pigeon; the claim key
# is device identity and belongs in the git-ignored prj.local.conf.
CONFIG_PIGEON=y
CONFIG_PIGEON_CONNECTOR_NIDD=y
CONFIG_PIGEON_ENDPOINT="nidd://VZWSCEF"
# One frame per wake carries every reading taken since the last one.
CONFIG_PIGEON_TELEMETRY_BATCH=y
# shadow.c parses target_config; the NIDD connector itself parses no JSON.
CONFIG_JSON_LIBRARY=y

CONFIG_NRF_MODEM_LIB=y
CONFIG_LTE_LINK_CONTROL=y
# Verizon serves NIDD over NB-IoT only.
CONFIG_LTE_NETWORK_MODE_NBIOT=y
# A 190-minute periodic TAU with a 60-second active time, the window in which a
# push can page the device. Verizon NB-IoT refused the 30-minute default.
CONFIG_LTE_PSM_REQ=y
CONFIG_LTE_PSM_REQ_RPTAU="00010011"
CONFIG_LTE_PSM_REQ_RAT="00100001"
# PCO rather than the modem's default ePCO when the Non-IP PDN is requested.
CONFIG_LTE_LC_PDN_LEGACY_PCO=y
# Reports a modem held back by its reset-loop restriction.
CONFIG_LTE_LC_MODEM_EVENTS_MODULE=y
# The sample opens no IP socket, so there is no DNS to fall back from.
CONFIG_LTE_LC_DNS_FALLBACK_MODULE=n

CONFIG_NETWORKING=y
CONFIG_NET_NATIVE=n
CONFIG_NET_SOCKETS=y
CONFIG_NET_SOCKETS_OFFLOAD=y

# Non-secure application image beside TF-M.
CONFIG_BUILD_WITH_TFM=y
CONFIG_TFM_PROFILE_TYPE_NOT_SET=y
CONFIG_TFM_CMAKE_BUILD_TYPE_RELEASE=y

CONFIG_LOG=y
CONFIG_LOG_DEFAULT_LEVEL=3

CONFIG_HEAP_MEM_POOL_SIZE=4096
CONFIG_MAIN_STACK_SIZE=4096
CONFIG_SYSTEM_WORKQUEUE_STACK_SIZE=2048
```

## src/main.c
```c
#include <modem/lte_lc.h>
#include <modem/nrf_modem_lib.h>
#include <pigeon.h>
#include <zephyr/kernel.h>
#include <zephyr/logging/log.h>

#include "shadow.h"

LOG_MODULE_REGISTER(main);

int main(void) {
  /* The modem's IMEI names the pigeon on NIDD, so device_id only labels log lines. */
  struct pigeon_config config = {
      .device_id = "nidd_init",
      .connector = {.type = PIGEON_CONNECTOR_NIDD},
  };

  int err = nrf_modem_lib_init();

  if (err) {
    LOG_ERR("nrf_modem_lib_init() failed: %d", err);
    return 0;
  }

  /* Before the attach: the Non-IP context must exist by then, and PSM and eDRX are written so
   * the attach request carries them. */
  err = pigeon_init(&config);
  if (err) {
    goto off;
  }

  LOG_INF("Attaching over NB-IoT");
  err = lte_lc_connect();
  if (err) {
    LOG_ERR("lte_lc_connect() failed: %d", err);
    goto off;
  }

  err = pigeon_nidd_start(shadow_event_cb);
  if (err) {
    LOG_ERR("pigeon_nidd_start() failed: %d", err);
    goto off;
  }

  shadow_loop();

  pigeon_nidd_stop();

off:
  /* Powered off rather than reset: the modem refuses to attach for 30 minutes after repeated
   * ungraceful resets. */
  (void)lte_lc_power_off();

  return 0;
}
```

## src/shadow.c
```c
/** @headerfile shadow.h */
#include "shadow.h"

#include <modem/lte_lc.h>
#include <pigeon.h>
#include <string.h>
#include <zephyr/data/json.h>
#include <zephyr/kernel.h>
#include <zephyr/logging/log.h>
#include <zephyr/sys/printk.h>

LOG_MODULE_REGISTER(shadow);

/* The carrier asks for at most four radio accesses an hour, uplink and downlink together, so a
 * wake comes no more often than every 15 minutes. */
#define WAKE_MIN_SEC 900
/* Under CONFIG_PIGEON_TELEMETRY_BATCH_DEPTH, so no reading is dropped to make room while every
 * wake delivers. */
#define READINGS_PER_WAKE 4

/* Signalled from the library's receive thread, so a pushed shadow is applied and reported while
 * the connection it arrived on is still up. */
K_SEM_DEFINE(shadow_wakeup, 0, 1);

void shadow_event_cb(enum pigeon_event ev, const struct pigeon_shadow_doc* shadow) {
  ARG_UNUSED(shadow);

  /* A report waits for a reply that this callback's thread receives, so it is made from
   * shadow_loop()'s thread instead. */
  if (ev == PIGEON_EVENT_SHADOW_UPDATE) {
    k_sem_give(&shadow_wakeup);
  }
}

/* target_config is opaque JSON to the library; this application decides what its keys mean. */
struct app_config {
  int telemetry_interval;
  bool reboot;
};

static const struct json_obj_descr app_config_descr[] = {
    JSON_OBJ_DESCR_PRIM(struct app_config, telemetry_interval, JSON_TOK_NUMBER),
    JSON_OBJ_DESCR_PRIM(struct app_config, reboot, JSON_TOK_TRUE),
};

/* Nothing persists across reboots: every boot applies the platform's target from here. */
static struct app_config applied = {.telemetry_interval = 1200};
static int32_t applied_version = -1;
/* The applied version's config asked for a reboot. */
static bool reboot_asked;
/* Reported, but not yet confirmed: reported again only at the next wake, since an event
 * already queued would otherwise start another pass at once and spend a radio access on it. */
static int32_t unconfirmed_version = -1;

/* Buffered readings would be lost with the RAM holding them, and the modem is powered off
 * first so the next boot can attach at once. */
static void sample_reboot(void) {
  LOG_WRN("Shadow v%d requested a reboot", applied_version);
  (void)pigeon_telemetry_flush_now();
  (void)pigeon_nidd_stop();
  (void)lte_lc_power_off();
  pigeon_reboot();
}

static int apply(const struct pigeon_shadow_doc* doc) {
  /* json_obj_parse() edits its input. */
  char buf[CONFIG_PIGEON_SHADOW_CONFIG_MAX];
  /* Keys absent from the target keep their value. reboot is a one-shot command. */
  struct app_config target = applied;

  strncpy(buf, doc->target_config, sizeof(buf) - 1);
  buf[sizeof(buf) - 1] = '\0';
  target.reboot = false;

  int64_t decoded =
      json_obj_parse(buf, strlen(buf), app_config_descr, ARRAY_SIZE(app_config_descr), &target);

  if (decoded < 0) {
    LOG_ERR("Shadow v%d: target_config did not parse: %lld", doc->target_version, decoded);
    return (int)decoded;
  }

  if (target.telemetry_interval < WAKE_MIN_SEC) {
    LOG_WRN(
        "Shadow v%d: telemetry_interval %d is under the carrier's 15-minute floor, using %d",
        doc->target_version, target.telemetry_interval, WAKE_MIN_SEC
    );
    target.telemetry_interval = WAKE_MIN_SEC;
  }

  applied = target;
  applied_version = doc->target_version;
  reboot_asked = target.reboot;
  LOG_INF("Applied shadow v%d: telemetry_interval=%d", applied_version, applied.telemetry_interval);

  return 0;
}

int shadow_sync(void) {
  struct pigeon_shadow_doc doc;
  int err = pigeon_shadow_get(&doc);

  if (err) {
    LOG_WRN("No shadow yet: %d", err);
    return err;
  }

  if (doc.target_version > applied_version) {
    err = apply(&doc);
    if (err) {
      return err;
    }
  }

  if (applied_version <= doc.current_version || applied_version == unconfirmed_version) {
    return 0;
  }

  char report[48];

  snprintk(report, sizeof(report), "{\"telemetry_interval\":%d}", applied.telemetry_interval);
  err = pigeon_shadow_report(applied_version, report);

  if (err == -ETIMEDOUT) {
    unconfirmed_version = applied_version;
    LOG_WRN("Shadow v%d report unconfirmed: reporting again at the next wake", applied_version);
    return 0;
  }
  if (err) {
    LOG_WRN("Shadow v%d report failed: %d", applied_version, err);
    return 0;
  }

  LOG_INF("Reported shadow v%d", applied_version);

  /* Only after the platform confirmed this version: the next boot then finds it converged and
   * does not reboot again, and an unconfirmed report cannot turn into a reboot loop. */
  if (reboot_asked) {
    sample_reboot();
  }

  return 0;
}

static void take_reading(void) {
  /* Counts from 1 at every boot, so a gap in the series shows which reading was lost. */
  static unsigned int reading;
  char buf[21];

  snprintk(buf, sizeof(buf), "%lld", (long long)(k_uptime_get() / MSEC_PER_SEC));

  int err = pigeon_telemetry_set("uptime_s", buf);

  snprintk(buf, sizeof(buf), "%u", ++reading);
  if (!err) {
    err = pigeon_telemetry_set("reading", buf);
  }
  if (!err) {
    err = pigeon_telemetry_record();
  }
  if (err) {
    LOG_WRN("Reading %u not recorded: %d", reading, err);
  }
}

void shadow_loop(void) {
  int taken = 0;

  /* The reply to HELLO carries the target, so this first pass costs no access of its own. */
  (void)shadow_sync();

  /* HELLO was this hour's first radio access, so the first wake is a full interval after it. */
  int64_t next_ms =
      k_uptime_get() + (int64_t)applied.telemetry_interval * MSEC_PER_SEC / READINGS_PER_WAKE;

  while (1) {
    int64_t now = k_uptime_get();

    if (now < next_ms) {
      if (k_sem_take(&shadow_wakeup, K_MSEC(next_ms - now)) == 0) {
        (void)shadow_sync();
      }
      continue;
    }

    take_reading();
    next_ms += (int64_t)applied.telemetry_interval * MSEC_PER_SEC / READINGS_PER_WAKE;

    if (++taken < READINGS_PER_WAKE) {
      continue;
    }

    /* The wake: one frame carries the four readings, and anything the platform owes this
     * device comes back on the connection that frame opened. */
    taken = 0;
    unconfirmed_version = -1;

    int err = pigeon_telemetry_flush_now();

    if (err) {
      LOG_WRN("Telemetry not sent: %d (the readings stay buffered)", err);
    }
    (void)shadow_sync();
  }
}
```

## src/shadow.h
```c
/** @file shadow.h
 *  @brief Applies the pigeon's target shadow, which over NIDD arrives as the
 *  reply to an uplink or as a push, and paces the device's radio use.
 */
#ifndef SHADOW_H
#define SHADOW_H

#include <pigeon.h>

/** pigeon_nidd_start() event callback: a newer shadow wakes shadow_loop() to
 *  apply it on this connection instead of at the next wake. Runs on the
 *  library's receive thread, which also receives the reply a report waits
 *  for, so it only signals. */
void shadow_event_cb(enum pigeon_event ev, const struct pigeon_shadow_doc* shadow);

/** Applies target_config if the platform has moved past what this boot
 *  applied, and reports the applied version while the platform holds an older
 *  one; a report that went unconfirmed is sent again at the next wake.
 *  @return 0 whether or not an update was applied, negative when no shadow is
 *  available. */
int shadow_sync(void);

/** Takes a reading every quarter of the wake interval and sends the four as
 *  one batch at each wake, syncing the shadow on the same connection. Does not
 *  return under normal operation. */
void shadow_loop(void);

#endif
```
