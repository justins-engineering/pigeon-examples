## CMakeLists.txt
```
cmake_minimum_required(VERSION 3.20.0)

# The probe drives the modem itself, a raw socket on a Non-IP PDN, so it takes
# neither the shared IP bring-up nor its board fragments.
set(SAMPLE_NETWORK OFF)
include(${CMAKE_CURRENT_SOURCE_DIR}/../common/app.cmake)

find_package(Zephyr REQUIRED HINTS $ENV{ZEPHYR_BASE})
project(nidd_probe)

include(${CMAKE_CURRENT_SOURCE_DIR}/../common/cert.cmake)

target_sources(app PRIVATE src/main.c)
```

## Kconfig
```
menu "NIDD probe sample"

config NIDD_PROBE_APN
  string "APN of the carrier's Non-IP service"
  default "VZWSCEF"
  help
    Verizon's SCEF APN. Frames sent on it reach the account's NiddService
    callback, and the account's downlinks arrive on it.

config NIDD_PROBE_DEDICATED_CID
  bool "Carry the Non-IP PDN on a context of its own"
  help
    Off, the default context becomes the Non-IP PDN and the board has no IP
    at all, which is all a NIDD-only plan allows. On, the default context
    keeps its IP PDN beside it, which needs a plan that carries IP data too.

config NIDD_PROBE_CLAIM_KEY
  string "Claim key, 32 hex digits"
  help
    The pigeon's 16-byte claim key: the HELLO frame carries it, and every
    platform frame's tag is keyed with it. Set it in the git-ignored
    prj.local.conf, never here.

module = NIDD_PROBE
module-str = NIDD probe sample
source "$(ZEPHYR_BASE)/subsys/logging/Kconfig.template.log_config"

endmenu

menu "Zephyr Kernel"
source "Kconfig.zephyr"
endmenu
```

## prj.conf
```kconfig
# A raw socket on a Non-IP PDN over NB-IoT: no IP stack and no pigeon
# connector. The claim key belongs in the git-ignored prj.local.conf.

CONFIG_NRF_MODEM_LIB=y
CONFIG_LTE_LINK_CONTROL=y
# Verizon delivers NIDD over NB-IoT only.
CONFIG_LTE_NETWORK_MODE_NBIOT=y
CONFIG_LTE_LC_PDN_MODULE=y
CONFIG_LTE_LC_PDN_ESM_STRERROR=y
# PCO rather than the modem's default ePCO when the PDN is requested.
CONFIG_LTE_LC_PDN_LEGACY_PCO=y
# Reports a modem held back by its reset-loop restriction.
CONFIG_LTE_LC_MODEM_EVENTS_MODULE=y
# A Non-IP PDN has no DNS to fall back from.
CONFIG_LTE_LC_DNS_FALLBACK_MODULE=n
# The library turns PSM off at boot, so a downlink finds the modem reachable
# until 'nidd psm on' asks for its defaults: a 30-minute TAU, 60 s active.
CONFIG_LTE_LC_PSM_MODULE=y
# The modem reports each sleep and wake, down to its shortest reportable sleep.
CONFIG_LTE_LC_MODEM_SLEEP_MODULE=y
CONFIG_LTE_LC_MODEM_SLEEP_NOTIFICATIONS=y
CONFIG_LTE_LC_MODEM_SLEEP_NOTIFICATIONS_THRESHOLD_MS=10240
# Every modem notification is logged, and some run long.
CONFIG_AT_MONITOR_HEAP_SIZE=1024

CONFIG_NETWORKING=y
CONFIG_NET_NATIVE=n
CONFIG_NET_SOCKETS=y
CONFIG_NET_SOCKETS_OFFLOAD=y

# 'nidd https' verifies the server against a root the modem stores.
CONFIG_MODEM_KEY_MGMT=y

# Platform frames end in a truncated HMAC-SHA256 keyed by the claim key.
CONFIG_PSA_CRYPTO=y
CONFIG_PSA_WANT_ALG_HMAC=y
CONFIG_PSA_WANT_ALG_SHA_256=y
CONFIG_PSA_WANT_KEY_TYPE_HMAC=y

# Non-secure application image beside TF-M.
CONFIG_BUILD_WITH_TFM=y
CONFIG_TFM_PROFILE_TYPE_NOT_SET=y
CONFIG_TFM_CMAKE_BUILD_TYPE_RELEASE=y

CONFIG_SHELL=y
CONFIG_AT_SHELL=y
# AT read commands end in '?', which the shell would take for a wildcard and
# answer with its usage text instead of running the command.
CONFIG_SHELL_WILDCARD=n
# Plain text on the console, so a capture reads without a terminal.
CONFIG_SHELL_VT100_COMMANDS=n

CONFIG_LOG=y
CONFIG_LOG_DEFAULT_LEVEL=3
CONFIG_LOG_MODE_IMMEDIATE=y

CONFIG_HEAP_MEM_POOL_SIZE=4096
CONFIG_MAIN_STACK_SIZE=4096
CONFIG_SYSTEM_WORKQUEUE_STACK_SIZE=2048
```

## src/main.c
```c
/*
 * Checks the carrier half of Non-IP Data Delivery from a bench board: attach
 * over NB-IoT, bring up a Non-IP PDN, print every downlink, and send test
 * frames from the shell.
 */
#include <errno.h>
#include <modem/at_monitor.h>
#include <modem/lte_lc.h>
#include <modem/modem_key_mgmt.h>
#include <modem/nrf_modem_lib.h>
#include <nrf_modem_at.h>
#include <psa/crypto.h>
#include <stdio.h>
#include <stdlib.h>
#include <string.h>
#include <zephyr/kernel.h>
#include <zephyr/logging/log.h>
#include <zephyr/net/socket.h>
#include <zephyr/net/tls_credentials.h>
#include <zephyr/random/random.h>
#include <zephyr/shell/shell.h>
#include <zephyr/sys/util.h>

LOG_MODULE_REGISTER(nidd_probe, CONFIG_NIDD_PROBE_LOG_LEVEL);

/* Above Verizon's 1358-byte ceiling, so a send can find where the modem or the
 * network draws its own line. */
#define FRAME_MAX 2048
#define CLAIM_KEY_LEN 16
/* The tag is the first TAG_LEN bytes of HMAC-SHA256, written as lowercase hex. */
#define TAG_LEN 8
#define TAG_CHARS (2 * TAG_LEN)
#define FRAME_TELEMETRY 0x01
#define FRAME_SHADOW_REPORT 0x02
#define FRAME_HELLO 0x04
/* Platform frame types have the top bit set. The carrier refuses a frame holding two adjacent
 * NUL bytes, so after the type byte each carries its numbers as text, two decimal integers with
 * a space between them and a newline after, and it ends in the tag. */
#define FRAME_FROM_PLATFORM 0x80
#define FRAME_SHADOW 0x81
#define FRAME_STATUS 0x82
/* A header number fits a u32. */
#define HEADER_DIGITS_MAX 10
#define STATUS_STORED 0
#define STATUS_PAUSED 1
#define STATUS_UNCLAIMED 2

/* Past this, waiting will not produce an NB-IoT attach. The modem is powered
 * off rather than reset: repeated ungraceful resets bar attach for 30 minutes. */
#define REGISTER_TIMEOUT_MIN 10
#define PDN_TIMEOUT_SEC 60

/* A tag of the probe's own: every sample keeps its credentials apart. */
#define HTTPS_SEC_TAG 48
#define HTTPS_TIMEOUT_SEC 30

/* The platform's root CA, terminated because the modem parses PEM as a string. */
static const char ca_cert[] = {
#include "GTS_Root_R4.crt.hex"
    0x00
};

BUILD_ASSERT(sizeof(ca_cert) < KB(4), "the modem's credential store caps a certificate at 4 KiB");

static K_SEM_DEFINE(registered, 0, 1);
static K_SEM_DEFINE(pdn_up, 0, 1);

static uint8_t nidd_cid;
static int nidd_fd = -1;
static uint8_t claim_key[CLAIM_KEY_LEN];
static bool claim_key_loaded;
static psa_key_id_t tag_key = PSA_KEY_ID_NULL;
static uint8_t rx_buf[FRAME_MAX];
static uint8_t tx_buf[FRAME_MAX];

/* Every unsolicited line the modem prints, verbatim: registration, PDN and
 * rate-control notices are read from these. */
AT_MONITOR(nidd_probe_notif, ANY, on_modem_notif);

static void on_modem_notif(const char* notif) {
  LOG_INF("modem: %.*s", (int)strcspn(notif, "\r\n"), notif);
}

/* Logs a command's response one line at a time. */
static void at_log(const char* cmd) {
  static char resp[512];
  int err = nrf_modem_at_cmd(resp, sizeof(resp), "%s", cmd);

  if (err < 0) {
    LOG_ERR("%s: %d", cmd, err);
    return;
  }
  if (err > 0) {
    LOG_ERR("%s: error type %d, code %d", cmd, nrf_modem_at_err_type(err), nrf_modem_at_err(err));
    return;
  }

  for (const char* line = resp; *line != '\0';) {
    size_t len = strcspn(line, "\r\n");

    if (len > 0 && !(len == 2 && memcmp(line, "OK", 2) == 0)) {
      LOG_INF("%s: %.*s", cmd, (int)len, line);
    }
    line += len;
    line += strspn(line, "\r\n");
  }
}

static void at_log_cid(const char* prefix) {
  char cmd[24];

  (void)snprintf(cmd, sizeof(cmd), "%s%u", prefix, nidd_cid);
  at_log(cmd);
}

/* The SIM's home network, from the first six digits of its IMSI (MCC and a three-digit MNC in
 * North America), tells whether the SIM is the carrier's at all. The rest of the IMSI names the
 * subscriber and stays off the console. Needs the SIM powered, so not before the modem is on. */
static void home_network_log(void) {
  char imsi[20];
  int err = nrf_modem_at_scanf("AT+CIMI", "%19s", imsi);

  if (err != 1) {
    LOG_ERR("AT+CIMI: %d", err);
    return;
  }
  LOG_INF("SIM home network (IMSI prefix): %.6s", imsi);
}

/* The credential store takes writes only while the modem is offline, so this
 * runs before the attach. */
static void ca_install(void) {
  bool exists = false;
  int err = modem_key_mgmt_exists(HTTPS_SEC_TAG, MODEM_KEY_MGMT_CRED_TYPE_CA_CHAIN, &exists);

  if (err == 0 && exists &&
      modem_key_mgmt_cmp(
          HTTPS_SEC_TAG, MODEM_KEY_MGMT_CRED_TYPE_CA_CHAIN, ca_cert, sizeof(ca_cert)
      ) == 0) {
    return;
  }
  if (exists) {
    (void)modem_key_mgmt_delete(HTTPS_SEC_TAG, MODEM_KEY_MGMT_CRED_TYPE_CA_CHAIN);
  }
  err = modem_key_mgmt_write(
      HTTPS_SEC_TAG, MODEM_KEY_MGMT_CRED_TYPE_CA_CHAIN, ca_cert, sizeof(ca_cert)
  );
  if (err) {
    LOG_ERR("modem_key_mgmt_write: %d", err);
  }
}

static void lte_handler(const struct lte_lc_evt* const evt) {
  switch (evt->type) {
    case LTE_LC_EVT_NW_REG_STATUS:
      if (evt->nw_reg_status == LTE_LC_NW_REG_REGISTERED_HOME ||
          evt->nw_reg_status == LTE_LC_NW_REG_REGISTERED_ROAMING) {
        k_sem_give(&registered);
      }
      break;
    case LTE_LC_EVT_LTE_MODE_UPDATE:
      LOG_INF(
          "LTE mode: %s", evt->lte_mode == LTE_LC_LTE_MODE_NBIOT  ? "NB-IoT"
                          : evt->lte_mode == LTE_LC_LTE_MODE_LTEM ? "LTE-M"
                                                                  : "none"
      );
      break;
    case LTE_LC_EVT_PSM_UPDATE:
      LOG_INF(
          "PSM from the network: TAU %d s, active time %d s", evt->psm_cfg.tau,
          evt->psm_cfg.active_time
      );
      break;
    case LTE_LC_EVT_PDN:
      if (evt->pdn.cid != nidd_cid) {
        break;
      }
      if (evt->pdn.type == LTE_LC_EVT_PDN_ACTIVATED) {
        k_sem_give(&pdn_up);
      } else if (evt->pdn.type == LTE_LC_EVT_PDN_ESM_ERROR) {
        LOG_WRN(
            "ESM error %d on CID %u: %s", evt->pdn.esm_err, nidd_cid,
            lte_lc_pdn_esm_strerror(evt->pdn.esm_err)
        );
      }
      break;
    default:
      break;
  }
}

static psa_key_id_t hmac_key_import(const uint8_t* key) {
  psa_key_attributes_t attr = PSA_KEY_ATTRIBUTES_INIT;
  psa_key_id_t id = PSA_KEY_ID_NULL;
  psa_status_t status;

  psa_set_key_usage_flags(&attr, PSA_KEY_USAGE_SIGN_MESSAGE);
  psa_set_key_algorithm(&attr, PSA_ALG_HMAC(PSA_ALG_SHA_256));
  psa_set_key_type(&attr, PSA_KEY_TYPE_HMAC);
  psa_set_key_bits(&attr, 8 * CLAIM_KEY_LEN);

  status = psa_import_key(&attr, key, CLAIM_KEY_LEN, &id);
  if (status != PSA_SUCCESS) {
    LOG_ERR("psa_import_key: %d", status);
  }

  return id;
}

/* The tag is the hex of the first TAG_LEN bytes of HMAC-SHA256 over everything
 * before it, compared without an early exit. */
static bool tag_verifies(psa_key_id_t key, const uint8_t* frame, size_t len) {
  uint8_t mac[PSA_HASH_LENGTH(PSA_ALG_SHA_256)];
  char hex[TAG_CHARS + 1];
  size_t mac_len;
  uint8_t diff = 0;
  psa_status_t status;

  if (len < TAG_CHARS) {
    return false;
  }
  status = psa_mac_compute(
      key, PSA_ALG_HMAC(PSA_ALG_SHA_256), frame, len - TAG_CHARS, mac, sizeof(mac), &mac_len
  );
  if (status != PSA_SUCCESS) {
    LOG_ERR("psa_mac_compute: %d", status);
    return false;
  }
  (void)bin2hex(mac, TAG_LEN, hex, sizeof(hex));
  for (size_t i = 0; i < TAG_CHARS; i++) {
    diff |= (uint8_t)hex[i] ^ frame[len - TAG_CHARS + i];
  }

  return diff == 0;
}

/* The API reference's STATUS STORED 7 example, tagged with a key of 16 zero
 * bytes: checking it first shows that a "tag bad" later is the frame's fault. */
static void tag_self_test(void) {
  static const uint8_t zero_key[CLAIM_KEY_LEN];
  static const char example[] =
      "\x82"
      "0 7\n"
      "db37ac5430ae1394";
  psa_key_id_t id = hmac_key_import(zero_key);

  if (id == PSA_KEY_ID_NULL) {
    return;
  }
  LOG_INF(
      "Tag check on the API reference example: %s",
      tag_verifies(id, (const uint8_t*)example, sizeof(example) - 1) ? "ok" : "bad"
  );
  (void)psa_destroy_key(id);
}

/* Without a key the probe still runs; only HELLO and the tag check need it. */
static void claim_key_load(void) {
  const char* hex = CONFIG_NIDD_PROBE_CLAIM_KEY;
  psa_status_t status;

  if (strlen(hex) == 2 * CLAIM_KEY_LEN &&
      hex2bin(hex, 2 * CLAIM_KEY_LEN, claim_key, sizeof(claim_key)) == CLAIM_KEY_LEN) {
    claim_key_loaded = true;
  } else {
    LOG_WRN("CONFIG_NIDD_PROBE_CLAIM_KEY is not 32 hex digits: no HELLO, no tag checks");
  }

  status = psa_crypto_init();
  if (status != PSA_SUCCESS) {
    LOG_ERR("psa_crypto_init: %d", status);
    return;
  }
  tag_self_test();
  if (claim_key_loaded) {
    tag_key = hmac_key_import(claim_key);
  }
}

static const char* status_name(uint32_t code) {
  switch (code) {
    case STATUS_STORED:
      return "STORED";
    case STATUS_PAUSED:
      return "PAUSED";
    case STATUS_UNCLAIMED:
      return "UNCLAIMED";
    default:
      return "unknown";
  }
}

/* Reads one header number, up to HEADER_DIGITS_MAX digits followed by `end`. Returns the
 * bytes read, `end` included, or 0 when the text is not that. */
static size_t header_number(const uint8_t* text, size_t len, uint8_t end, uint32_t* value) {
  uint64_t number = 0;
  size_t i = 0;

  while (i < len && i < HEADER_DIGITS_MAX && text[i] >= '0' && text[i] <= '9') {
    number = number * 10 + (text[i] - '0');
    i++;
  }
  if (i == 0 || i == len || text[i] != end || number > UINT32_MAX) {
    return 0;
  }
  *value = (uint32_t)number;

  return i + 1;
}

static void downlink_log(const uint8_t* frame, size_t len) {
  uint32_t first;
  uint32_t second;
  size_t body;
  size_t used;
  size_t header = 0;

  LOG_INF("Downlink, %zu bytes", len);
  LOG_HEXDUMP_INF(frame, len, "downlink");

  if (len < 1 + TAG_CHARS || (frame[0] & FRAME_FROM_PLATFORM) == 0) {
    LOG_INF("Downlink tag none: not a platform frame");
    return;
  }
  /* The header and any payload lie between the type byte and the tag. */
  body = len - 1 - TAG_CHARS;
  used = header_number(&frame[1], body, ' ', &first);
  if (used > 0) {
    size_t rest = header_number(&frame[1 + used], body - used, '\n', &second);

    header = rest > 0 ? used + rest : 0;
  }

  if (header == 0) {
    LOG_INF("Platform frame 0x%02x without a header", frame[0]);
  } else if (frame[0] == FRAME_SHADOW) {
    LOG_INF(
        "SHADOW target_version %u, current_version %u, target_config %zu bytes",
        (unsigned int)first, (unsigned int)second, body - header
    );
  } else if (frame[0] == FRAME_STATUS && header == body) {
    LOG_INF("STATUS %s, arg %u", status_name(first), (unsigned int)second);
  } else {
    LOG_INF("Platform frame of unknown type 0x%02x or length", frame[0]);
  }

  if (tag_key == PSA_KEY_ID_NULL) {
    LOG_WRN("Downlink tag unchecked: no claim key");
  } else {
    LOG_INF("Downlink tag %s", tag_verifies(tag_key, frame, len) ? "ok" : "bad");
  }
}

static int frame_send(const struct shell* sh, const uint8_t* frame, size_t len) {
  ssize_t ret;

  if (nidd_fd < 0) {
    shell_error(sh, "The Non-IP socket is not open");
    return -ENOTCONN;
  }

  ret = zsock_send(nidd_fd, frame, len, 0);
  if (ret < 0) {
    LOG_ERR("send(%zu bytes) returned %zd, errno %d", len, ret, errno);
    return -errno;
  }
  LOG_INF("send(%zu bytes) returned %zd", len, ret);
  /* HELLO carries the claim key, which stays off the console. */
  if (frame[0] != FRAME_HELLO) {
    LOG_HEXDUMP_INF(frame, len, "uplink");
  }

  return 0;
}

/* Byte 0 is 0x00, a type reserved in both directions, so filler is never read
 * as a frame; the counting pattern shows truncation in what arrives. */
static int cmd_raw(const struct shell* sh, size_t argc, char** argv) {
  char* end;
  unsigned long len = strtoul(argv[1], &end, 10);

  ARG_UNUSED(argc);

  if (*end != '\0' || len == 0 || len > sizeof(tx_buf)) {
    shell_error(sh, "Size must be 1 to %u bytes", (unsigned int)sizeof(tx_buf));
    return -EINVAL;
  }
  for (size_t i = 0; i < len; i++) {
    tx_buf[i] = (uint8_t)i;
  }

  return frame_send(sh, tx_buf, len);
}

static int cmd_hello(const struct shell* sh, size_t argc, char** argv) {
  ARG_UNUSED(argc);
  ARG_UNUSED(argv);

  if (!claim_key_loaded) {
    shell_error(sh, "No claim key: set CONFIG_NIDD_PROBE_CLAIM_KEY in prj.local.conf");
    return -ENOENT;
  }
  tx_buf[0] = FRAME_HELLO;
  (void)bin2hex(claim_key, CLAIM_KEY_LEN, (char*)&tx_buf[1], sizeof(tx_buf) - 1);

  return frame_send(sh, tx_buf, 1 + 2 * CLAIM_KEY_LEN);
}

/* Each frame carries the next sequence number, so a burst shows which frames
 * were lost on the way. The frame opens with a send sequence, which the
 * platform uses to store a frame the carrier delivers twice only once; a random
 * one serves the probe, whose frames only have to differ. */
static int cmd_telemetry(const struct shell* sh, size_t argc, char** argv) {
  static unsigned int seq;
  int len;

  ARG_UNUSED(argc);
  ARG_UNUSED(argv);

  seq++;
  tx_buf[0] = FRAME_TELEMETRY;
  len = snprintf(
      (char*)&tx_buf[1], sizeof(tx_buf) - 1, "%u\n{\"probe_seq\":\"%u\",\"uptime_s\":\"%u\"}",
      (unsigned int)sys_rand32_get(), seq, (unsigned int)(k_uptime_get() / MSEC_PER_SEC)
  );
  LOG_INF("TELEMETRY probe_seq %u", seq);

  return frame_send(sh, tx_buf, 1 + len);
}

/* The platform judges convergence by version alone, so the report carries an
 * empty config rather than echo one that may not fit a frame. */
static int cmd_report(const struct shell* sh, size_t argc, char** argv) {
  char* end;
  long version = strtol(argv[1], &end, 10);
  int len;

  ARG_UNUSED(argc);

  if (*end != '\0' || version < 0 || version > INT32_MAX) {
    shell_error(sh, "Version must be 0 to 2147483647");
    return -EINVAL;
  }
  tx_buf[0] = FRAME_SHADOW_REPORT;
  len = snprintf(
      (char*)&tx_buf[1], sizeof(tx_buf) - 1, "{\"current_config\":{},\"current_version\":%ld}",
      version
  );

  return frame_send(sh, tx_buf, 1 + len);
}

static int cmd_psm(const struct shell* sh, size_t argc, char** argv) {
  bool enable = strcmp(argv[1], "on") == 0;
  int err;

  ARG_UNUSED(argc);

  if (!enable && strcmp(argv[1], "off") != 0) {
    shell_error(sh, "Say on or off");
    return -EINVAL;
  }
  err = lte_lc_psm_req(enable);
  LOG_INF("PSM request %s: %d", argv[1], err);

  return err;
}

/* The modem documents RAI_NO_DATA for connected sockets; whether a raw one
 * takes it decides how a NIDD device ends its radio time early. */
static int cmd_rai(const struct shell* sh, size_t argc, char** argv) {
  int value = RAI_NO_DATA;

  ARG_UNUSED(argc);
  ARG_UNUSED(argv);

  if (nidd_fd < 0) {
    shell_error(sh, "The Non-IP socket is not open");
    return -ENOTCONN;
  }
  if (zsock_setsockopt(nidd_fd, ZSOCK_SOL_SOCKET, SO_RAI, &value, sizeof(value)) != 0) {
    LOG_ERR("SO_RAI RAI_NO_DATA: errno %d", errno);
    return -errno;
  }
  LOG_INF("SO_RAI RAI_NO_DATA: accepted");

  return 0;
}

/* One GET of / over the default context, with the Non-IP socket still open: the
 * status line and the byte count show whether IP works beside it. */
static int cmd_https(const struct shell* sh, size_t argc, char** argv) {
  const char* host = argv[1];
  struct zsock_addrinfo hints = {.ai_socktype = NET_SOCK_STREAM};
  struct zsock_addrinfo* res;
  sec_tag_t tags[] = {HTTPS_SEC_TAG};
  int verify = ZSOCK_TLS_PEER_VERIFY_REQUIRED;
  struct zsock_timeval timeout = {.tv_sec = HTTPS_TIMEOUT_SEC};
  static char buf[512];
  size_t total = 0;
  ssize_t n;
  int fd;
  int err = zsock_getaddrinfo(host, "443", &hints, &res);

  ARG_UNUSED(argc);

  if (err) {
    shell_error(sh, "Resolving %s failed: %d", host, err);
    return -EHOSTUNREACH;
  }
  fd = zsock_socket(res->ai_family, NET_SOCK_STREAM, NET_IPPROTO_TLS_1_2);
  if (fd < 0) {
    err = -errno;
    LOG_ERR("TLS socket: errno %d", -err);
    zsock_freeaddrinfo(res);
    return err;
  }
  if (zsock_setsockopt(fd, ZSOCK_SOL_TLS, ZSOCK_TLS_SEC_TAG_LIST, tags, sizeof(tags)) != 0 ||
      zsock_setsockopt(fd, ZSOCK_SOL_TLS, ZSOCK_TLS_HOSTNAME, host, strlen(host)) != 0 ||
      zsock_setsockopt(fd, ZSOCK_SOL_TLS, ZSOCK_TLS_PEER_VERIFY, &verify, sizeof(verify)) != 0 ||
      zsock_setsockopt(fd, ZSOCK_SOL_SOCKET, ZSOCK_SO_RCVTIMEO, &timeout, sizeof(timeout)) != 0 ||
      zsock_connect(fd, res->ai_addr, res->ai_addrlen) != 0) {
    err = -errno;
    LOG_ERR("TLS connect to %s: errno %d", host, -err);
    goto out;
  }

  n = snprintf(
      buf, sizeof(buf),
      "GET / HTTP/1.1\r\nHost: %s\r\nUser-Agent: nidd-probe\r\nConnection: close\r\n\r\n", host
  );
  if (zsock_send(fd, buf, n, 0) != n) {
    err = -errno;
    LOG_ERR("HTTPS send: errno %d", -err);
    goto out;
  }
  while ((n = zsock_recv(fd, buf, sizeof(buf) - 1, 0)) > 0) {
    if (total == 0) {
      buf[n] = '\0';
      LOG_INF("HTTPS %s: %.*s", host, (int)strcspn(buf, "\r\n"), buf);
    }
    total += n;
  }
  err = n < 0 ? -errno : 0;
  LOG_INF("HTTPS %s: %zu bytes, then %s %d", host, total, n < 0 ? "errno" : "close", -err);

out:
  (void)zsock_close(fd);
  zsock_freeaddrinfo(res);

  return err;
}

SHELL_STATIC_SUBCMD_SET_CREATE(
    nidd_cmds, SHELL_CMD_ARG(raw, NULL, "<bytes> Send that many filler bytes", cmd_raw, 2, 0),
    SHELL_CMD(hello, NULL, "Send HELLO carrying the claim key", cmd_hello),
    SHELL_CMD(telemetry, NULL, "Send TELEMETRY with a sequence number", cmd_telemetry),
    SHELL_CMD_ARG(report, NULL, "<version> Send SHADOW_REPORT for that version", cmd_report, 2, 0),
    SHELL_CMD_ARG(psm, NULL, "<on|off> Request PSM or stop requesting it", cmd_psm, 2, 0),
    SHELL_CMD(rai, NULL, "Set RAI_NO_DATA on the Non-IP socket", cmd_rai),
    SHELL_CMD_ARG(https, NULL, "<host> GET / over the IP context", cmd_https, 2, 0),
    SHELL_SUBCMD_SET_END
);
SHELL_CMD_REGISTER(nidd, &nidd_cmds, "NIDD probe frames", NULL);

static int socket_open(void) {
  int pdn_id = lte_lc_pdn_id_get(nidd_cid);
  int fd;

  if (pdn_id < 0) {
    LOG_ERR("lte_lc_pdn_id_get: %d", pdn_id);
    return pdn_id;
  }
  LOG_INF("PDN ID %d on CID %u", pdn_id, nidd_cid);

  fd = zsock_socket(NET_AF_PACKET, NET_SOCK_RAW, 0);
  if (fd < 0) {
    LOG_ERR("zsock_socket: errno %d", errno);
    return -errno;
  }

  /* An unbound raw socket rides the default PDN. */
  if (IS_ENABLED(CONFIG_NIDD_PROBE_DEDICATED_CID) &&
      zsock_setsockopt(fd, ZSOCK_SOL_SOCKET, SO_BINDTOPDN, &pdn_id, sizeof(pdn_id)) != 0) {
    LOG_ERR("SO_BINDTOPDN: errno %d", errno);
    (void)zsock_close(fd);
    return -errno;
  }

  return fd;
}

int main(void) {
  int err = nrf_modem_lib_init();

  if (err) {
    LOG_ERR("nrf_modem_lib_init: %d", err);
    return 0;
  }

  at_log("AT+CGMR");
  at_log("AT+CGSN=1");
  at_log("AT+CGDCONT?");
  claim_key_load();
  ca_install();

  if (IS_ENABLED(CONFIG_NIDD_PROBE_DEDICATED_CID)) {
    /* Set rather than assumed: a run without a dedicated context may have left
     * CID 0 Non-IP. No APN means the one the subscription names. */
    err = lte_lc_pdn_ctx_configure(0, NULL, LTE_LC_PDN_FAM_IPV4V6, NULL);
    if (err == 0) {
      err = lte_lc_pdn_ctx_create(&nidd_cid);
    }
  } else {
    err = lte_lc_pdn_default_ctx_events_enable();
  }
  if (err) {
    LOG_ERR("PDP context setup: %d", err);
    goto stop;
  }

  err = lte_lc_pdn_ctx_configure(nidd_cid, CONFIG_NIDD_PROBE_APN, LTE_LC_PDN_FAM_NONIP, NULL);
  if (err) {
    LOG_ERR("lte_lc_pdn_ctx_configure: %d", err);
    goto stop;
  }

  LOG_INF("Attaching over NB-IoT, Non-IP on CID %u, APN %s", nidd_cid, CONFIG_NIDD_PROBE_APN);
  err = lte_lc_connect_async(lte_handler);
  if (err) {
    LOG_ERR("lte_lc_connect_async: %d", err);
    goto stop;
  }

  if (k_sem_take(&registered, K_MINUTES(REGISTER_TIMEOUT_MIN)) != 0) {
    LOG_ERR("Not registered after %d minutes", REGISTER_TIMEOUT_MIN);
    at_log("AT%XICCID");
    home_network_log();
    at_log("AT+CEREG?");
    at_log("AT%XMONITOR");
    at_log("AT+CESQ");
    at_log("AT+CEER");
    goto stop;
  }

  at_log("AT%XICCID");
  home_network_log();
  at_log("AT%XMONITOR");

  if (IS_ENABLED(CONFIG_NIDD_PROBE_DEDICATED_CID)) {
    int esm = 0;

    err = lte_lc_pdn_activate(nidd_cid, &esm, NULL);
    if (err) {
      LOG_ERR("lte_lc_pdn_activate: %d, ESM %d: %s", err, esm, lte_lc_pdn_esm_strerror(esm));
      goto stop;
    }
  }

  if (k_sem_take(&pdn_up, K_SECONDS(PDN_TIMEOUT_SEC)) != 0) {
    LOG_ERR("Non-IP PDN on CID %u not active after %d s", nidd_cid, PDN_TIMEOUT_SEC);
    at_log("AT+CGACT?");
    at_log("AT+CEER");
    goto stop;
  }

  at_log("AT+CGDCONT?");
  at_log("AT+CGACT?");
  if (nidd_cid != 0) {
    at_log("AT+CGCONTRDP=0");
  }
  at_log_cid("AT+CGCONTRDP=");
  at_log_cid("AT+CGAPNRC=");
  at_log("AT+CCIOTOPT?");

  nidd_fd = socket_open();
  if (nidd_fd < 0) {
    goto stop;
  }
  LOG_INF("Ready: 'nidd raw <bytes>' sends filler, 'nidd hello' sends HELLO");

  for (;;) {
    ssize_t len = zsock_recv(nidd_fd, rx_buf, sizeof(rx_buf), 0);

    if (len < 0) {
      LOG_ERR("zsock_recv: errno %d", errno);
      break;
    }
    downlink_log(rx_buf, len);
  }

  err = nidd_fd;
  nidd_fd = -1;
  (void)zsock_close(err);

stop:
  LOG_INF("Powering the modem off");
  (void)lte_lc_power_off();

  return 0;
}
```
