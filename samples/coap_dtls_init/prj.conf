## CMakeLists.txt
```
cmake_minimum_required(VERSION 3.20.0)

# This sample authenticates with a pre-shared key.
set(SAMPLE_TLS psk)
include(${CMAKE_CURRENT_SOURCE_DIR}/../common/app.cmake)

find_package(Zephyr REQUIRED HINTS $ENV{ZEPHYR_BASE})
project(coap_dtls_init)

target_sources(app PRIVATE src/main.c src/shadow.c)

include(${CMAKE_CURRENT_SOURCE_DIR}/../common/net.cmake)
```

## Kconfig
```
menu "Zephyr Kernel"
source "Kconfig.zephyr"
endmenu
```

## Kconfig.sysbuild
```
rsource "../Kconfig.sysbuild.signing"

# native_sim and the ESP32-C6 boot the application image directly. The
# Feathers boot through MCUboot: without it the image links into the SoC's
# default partition and a mass-erased chip has nothing at address 0.
choice BOOTLOADER
	default BOOTLOADER_MCUBOOT if SOC_SERIES_NRF91
	default BOOTLOADER_NONE
endchoice

source "share/sysbuild/Kconfig"
```

## sysbuild.conf
```
# esp32c6_devkitc/Kconfig.sysbuild defaults BOOTLOADER to MCUBOOT (Espressif
# boards override the generic BOOTLOADER_NONE default -- unlike the nRF9160
# boards this sample also targets, where MCUboot stays opt-in and this line
# is a no-op). This sample has no sysbuild/mcuboot child-image config or
# signing key wired up (no CONFIG_PIGEON_FOTA here), so there is nothing for
# SB_CONFIG_BOOTLOADER_MCUBOOT to actually build against on ESP32-C6 --
# same override, same reasoning, as this repo's ws_init/wifi_init samples.
SB_CONFIG_BOOTLOADER_NONE=y
```

## prj.conf
```kconfig
# CoAP over DTLS/UDP with a pre-shared key: one long-lived DTLS session
# carrying RFC 7252 confirmable exchanges. The endpoint and the PSK belong in
# the git-ignored prj.local.conf. No bearer token: the handshake is the
# device's whole authentication on this connector.
CONFIG_PIGEON=y
CONFIG_PIGEON_CONNECTOR_COAP=y
CONFIG_PIGEON_COAP_TRANSPORT_UDP=y
# The modem's credential store outlives a reflash and is keyed by tag, so each
# sample here owns a distinct one rather than the shared default.
CONFIG_PIGEON_COAP_SEC_TAG=45
CONFIG_PIGEON_LOG_UPLOAD=y
# Half the buffer per batch, so an upload spans several RFC 7959 Block1
# transfers rather than fitting in one.
CONFIG_PIGEON_LOG_UPLOAD_BUF_SIZE=4096
CONFIG_PIGEON_LOG_UPLOAD_BATCH_SIZE=2048

CONFIG_PICOLIBC=y
CONFIG_STD_C17=y
CONFIG_MISRA_SANE=y

CONFIG_HEAP_MEM_POOL_SIZE=8192
CONFIG_MAIN_STACK_SIZE=8192
CONFIG_SYSTEM_WORKQUEUE_STACK_SIZE=4096
# Logging from the connection manager's event callbacks overflows the default.
CONFIG_NET_MGMT_EVENT_STACK_SIZE=2048

CONFIG_NETWORKING=y
CONFIG_NET_SOCKETS=y
CONFIG_NET_SOCKETS_SOCKOPT_TLS=y
CONFIG_NET_IPV4=y
CONFIG_NET_IPV6=y
CONFIG_NET_CONNECTION_MANAGER=y
CONFIG_NET_CONNECTION_MANAGER_MONITOR_STACK_SIZE=1024

CONFIG_LOG=y
CONFIG_LOG_DEFAULT_LEVEL=3
# The log-upload backend fills a ring buffer that is lock-free only with a
# single producer, which deferred mode makes the log thread; immediate mode
# runs the backend on whichever thread logged.
CONFIG_LOG_MODE_DEFERRED=y
CONFIG_LOG_PROCESS_THREAD_STACK_SIZE=2048
# Lets the shadow's "log" field silence and restore logging at runtime.
CONFIG_LOG_RUNTIME_FILTERING=y
```

## boards/circuitdojo_feather_nrf9151_ns.conf
```kconfig
# Beyond ../../common/boards/nrf91.conf and nrf9151.conf. DTLS, the PSK
# ciphersuites and the credential store all live in the modem, so nothing
# here configures mbedTLS.

# No MCUboot partition rebalance in this sample, so the application has only
# the SoC's stock non-secure slot to fit in.
CONFIG_SIZE_OPTIMIZATIONS=y
```

## boards/circuitdojo_feather_nrf9160_ns.conf
```kconfig
# Beyond ../../common/boards/nrf91.conf. DTLS, the PSK ciphersuites and the
# credential store all live in the modem, so nothing here configures mbedTLS.

# No MCUboot partition rebalance in this sample, so the application has only
# the SoC's stock non-secure slot to fit in.
CONFIG_SIZE_OPTIMIZATIONS=y
```

## boards/esp32c6_devkitc_hpcore.conf
```kconfig
# Beyond ../../common/boards/esp32c6.conf.

# DTLS over the board's own UDP socket, in mbedTLS. The Feathers offload all
# of this to the modem, so none of it appears in their board files.
CONFIG_NET_SOCKETS_ENABLE_DTLS=y
# Lets the session survive a NAT rebind without a re-handshake; without it
# pigeon's CID request fails and is logged rather than fatal.
CONFIG_MBEDTLS_SSL_DTLS_CONNECTION_ID=y
```

## boards/native_sim_native_64.conf
```kconfig
# Beyond ../../common/boards/native_sim.conf.

# DTLS over the offloaded UDP socket, in mbedTLS. The Feathers offload all of
# this to the modem, so none of it appears in their board files.
CONFIG_NET_SOCKETS_ENABLE_DTLS=y
# Lets the session survive a NAT rebind without a re-handshake; without it
# pigeon's CID request fails and is logged rather than fatal.
CONFIG_MBEDTLS_SSL_DTLS_CONNECTION_ID=y
```

## src/main.c
```c
#include <pigeon.h>
#include <zephyr/kernel.h>

#include "net_connect.h"
#include "shadow.h"

/* A Kconfig string is always defined, so "" is its only way of saying "not
 * supplied"; NULL leaves whatever already sits under the sec tag in place. */
#define PSK_CONF_OR_NULL(s) ((s)[0] ? (s) : NULL)

int main(void) {
  /* The endpoint and the PSK come from Kconfig. device_id only names this
   * device in its own logs; the platform identifies it by the PSK identity,
   * which is why this connector needs no bearer token. */
  struct pigeon_config config = {
      .device_id = "pigeon-coap-dtls-sample",
      .connector =
          {
              .type = PIGEON_CONNECTOR_COAP,
              .coap =
                  {
                      .tls_psk_identity = PSK_CONF_OR_NULL(CONFIG_PIGEON_COAP_TLS_PSK_IDENTITY),
                      .tls_psk_secret = PSK_CONF_OR_NULL(CONFIG_PIGEON_COAP_TLS_PSK_SECRET),
                  },
          },
  };

  int err = net_prepare();

  if (err) {
    return err;
  }

  /* Registers the PSK, so it runs before the interface comes up: a modem's
   * credential store only accepts writes while it is offline. */
  err = pigeon_init(&config);
  if (err) {
    return err;
  }

  err = net_connect();
  if (err) {
    return err;
  }

  shadow_loop();

  return net_disconnect();
}
```

## src/shadow.c
```c
/** @headerfile shadow.h */
#include "shadow.h"

#include <pigeon.h>
#include <string.h>
#include <zephyr/data/json.h>
#include <zephyr/kernel.h>
#include <zephyr/logging/log.h>
#include <zephyr/logging/log_ctrl.h>
#include <zephyr/sys/printk.h>

#include "net_connect.h"

LOG_MODULE_REGISTER(shadow);

/* target_config is opaque JSON to the library; this application decides what
 * its keys mean. */
struct app_shadow_config {
  bool log;
  int telemetry_interval;
  bool reboot;
};

static const struct json_obj_descr app_shadow_config_descr[] = {
    JSON_OBJ_DESCR_PRIM(struct app_shadow_config, log, JSON_TOK_TRUE),
    JSON_OBJ_DESCR_PRIM(struct app_shadow_config, telemetry_interval, JSON_TOK_NUMBER),
    JSON_OBJ_DESCR_PRIM(struct app_shadow_config, reboot, JSON_TOK_TRUE),
};

/* Defaults applied before the first sync of a boot. Nothing persists across
 * reboots, so every boot re-applies the platform's target from here. */
static struct app_shadow_config current_config = {
    .log = false,
    .telemetry_interval = 60,
    .reboot = false,
};

/* One call covers every module, so the shadow's "log" field really silences
 * and restores output. */
static void set_all_log_levels(uint32_t level) {
  uint32_t module_count = log_src_cnt_get(Z_LOG_LOCAL_DOMAIN_ID);

  for (uint32_t i = 0; i < module_count; i++) {
    log_filter_set(NULL, Z_LOG_LOCAL_DOMAIN_ID, (int16_t)i, level);
  }
}

/* Both keys ride one telemetry exchange. poll_count restarting at 1 doubles
 * as a reboot indicator on the dashboard. */
static void report_telemetry(void) {
  static unsigned int poll_count;
  char buf[21];

  snprintk(buf, sizeof(buf), "%lld", (long long)(k_uptime_get() / 1000));

  int err = pigeon_telemetry_set("uptime_s", buf);

  snprintk(buf, sizeof(buf), "%u", ++poll_count);

  if (!err) {
    err = pigeon_telemetry_set("poll_count", buf);
  }

  if (!err) {
    err = pigeon_telemetry_flush();
  }

  if (err) {
    LOG_WRN("Telemetry report failed: %d", err);
  }
}

int shadow_sync(void) {
  struct pigeon_shadow_doc doc;
  int err = pigeon_shadow_get(&doc);

  if (err) {
    LOG_ERR("Failed to fetch device shadow: %d", err);
    return err;
  }

  LOG_INF(
      "Shadow fetched: target_version=%d current_version=%d updated_at=%lld", doc.target_version,
      doc.current_version, doc.updated_at
  );

  report_telemetry();

  if (doc.target_version == doc.current_version) {
    LOG_INF("Shadow already converged at version %d; nothing to apply", doc.current_version);
    return 0;
  }

  /* json_obj_parse() edits its input, and target_config only lives until the
   * next fetch. */
  char config_buf[CONFIG_PIGEON_SHADOW_CONFIG_MAX];

  strncpy(config_buf, doc.target_config, sizeof(config_buf) - 1);
  config_buf[sizeof(config_buf) - 1] = '\0';

  /* Keys absent from a partial update keep their current value. reboot is a
   * one-shot command and always starts false. */
  struct app_shadow_config target = current_config;
  target.reboot = false;

  int64_t decoded = json_obj_parse(
      config_buf, strlen(config_buf), app_shadow_config_descr, ARRAY_SIZE(app_shadow_config_descr),
      &target
  );

  if (decoded < 0) {
    LOG_ERR("Failed to parse shadow target_config '%s': %lld", doc.target_config, decoded);
    return (int)decoded;
  }

  if (target.log != current_config.log) {
    LOG_INF(
        "Shadow v%d: log %s -> %s", doc.target_version, current_config.log ? "true" : "false",
        target.log ? "true" : "false"
    );
    set_all_log_levels(target.log ? CONFIG_LOG_DEFAULT_LEVEL : LOG_LEVEL_NONE);
  }

  if (target.telemetry_interval != current_config.telemetry_interval) {
    LOG_INF(
        "Shadow v%d: telemetry_interval %d -> %d", doc.target_version,
        current_config.telemetry_interval, target.telemetry_interval
    );
  }

  current_config.log = target.log;
  current_config.telemetry_interval = target.telemetry_interval;

  LOG_INF(
      "Applied shadow v%d: log=%s telemetry_interval=%d", doc.target_version,
      current_config.log ? "true" : "false", current_config.telemetry_interval
  );

  /* current_version is whatever this device reports, so the report goes out
   * even if a newer target is already pending by the time it lands. */
  char report_buf[128];
  int encode_err = json_obj_encode_buf(
      app_shadow_config_descr, ARRAY_SIZE(app_shadow_config_descr), &current_config, report_buf,
      sizeof(report_buf)
  );

  if (encode_err) {
    LOG_ERR("Failed to encode current_config for shadow report: %d", encode_err);
  } else {
    int report_err = pigeon_shadow_report(doc.target_version, report_buf);

    if (report_err) {
      LOG_WRN("Shadow report-back failed: %d", report_err);
    } else {
      LOG_INF("Reported current_config back to platform at v%d", doc.target_version);
    }
  }

  /* "reboot" is a command, not state: kept out of current_config so it is
   * never seen as unchanged and re-run on every poll. net_disconnect() comes
   * first so a link is closed rather than dropped; on a modem an ungraceful
   * reset also trips its reset-loop protection. */
  if (target.reboot) {
    LOG_WRN("Shadow v%d requested reboot; disconnecting and rebooting now", doc.target_version);
    net_disconnect();
    pigeon_reboot();
  }

  return 0;
}

void shadow_loop(void) {
  while (1) {
    shadow_sync();

    LOG_INF("Next shadow poll in %d s", current_config.telemetry_interval);
    k_sleep(K_SECONDS(current_config.telemetry_interval));
  }
}
```
