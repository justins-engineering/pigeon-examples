## CMakeLists.txt
```
cmake_minimum_required(VERSION 3.20.0)

# No transport, so no board network fragment and no bring-up source.
set(SAMPLE_NETWORK OFF)
include(${CMAKE_CURRENT_SOURCE_DIR}/../common/app.cmake)

find_package(Zephyr REQUIRED HINTS $ENV{ZEPHYR_BASE})
project(shadow_model)

target_sources(app PRIVATE src/main.c)
```

## Kconfig.sysbuild
```
rsource "../Kconfig.sysbuild.signing"

# A Feather has nothing at address 0 without MCUboot. The ESP32-C6 board
# defaults to MCUboot, and a single image is enough here.
choice BOOTLOADER
	default BOOTLOADER_NONE if BOARD_ESP32C6_DEVKITC
	default BOOTLOADER_MCUBOOT if SOC_SERIES_NRF91
endchoice

source "share/sysbuild/Kconfig"
```

## prj.conf
```kconfig
# CONFIG_PIGEON stays off: it selects a connector, and this sample has no
# transport. pigeon_init() and the shadow structs are available without it.

CONFIG_LOG=y
CONFIG_LOG_DEFAULT_LEVEL=3
CONFIG_LOG_MODE_IMMEDIATE=y

CONFIG_HEAP_MEM_POOL_SIZE=8192
CONFIG_MAIN_STACK_SIZE=8192
```

## src/main.c
```c
#include <pigeon.h>
#include <zephyr/kernel.h>
#include <zephyr/logging/log.h>

LOG_MODULE_REGISTER(shadow_model, LOG_LEVEL_INF);

/* Builds the shadow structs a connector exchanges with the platform, with no
 * transport underneath, and logs what a sync would send and receive. */
int main(void) {
  /* A connector reads its endpoint and token from Kconfig, not from here. */
  struct pigeon_config config = {
      .device_id = "demo-pigeon-0003",
      .connector = {.type = PIGEON_CONNECTOR_HTTPS},
  };

  int err = pigeon_init(&config);
  if (err) {
    return err;
  }

  /* What a shadow fetch returns. */
  struct pigeon_shadow_doc shadow = {
      .target_version = 2,
      .current_version = 1,
      .target_config = "{\"report_interval_s\":60}",
      .current_config = "{\"report_interval_s\":300}",
      .updated_at = 1751500000,
  };

  LOG_INF(
      "shadow target=v%d current=v%d target_config=%s current_config=%s", shadow.target_version,
      shadow.current_version, shadow.target_config, shadow.current_config
  );

  /* What a shadow update carries to move current_config toward the target. */
  struct pigeon_shadow_update_request update = {
      .target_config = "{\"report_interval_s\":60}",
  };

  LOG_INF("shadow update request target_config=%s", update.target_config);

  return 0;
}
```
