## CMakeLists.txt
```
cmake_minimum_required(VERSION 3.20.0)

# This sample authenticates with a pre-shared key.
set(SAMPLE_TLS psk)
include(${CMAKE_CURRENT_SOURCE_DIR}/../common/app.cmake)

find_package(Zephyr REQUIRED HINTS $ENV{ZEPHYR_BASE})
project(coap_tcp_init)

target_sources(app PRIVATE src/main.c src/shadow.c)

include(${CMAKE_CURRENT_SOURCE_DIR}/../common/net.cmake)
```

## Kconfig.sysbuild
```
rsource "../Kconfig.sysbuild.signing"

# A Feather has nothing at address 0 without MCUboot. The ESP32-C6 board
# defaults to MCUboot, and a single image is enough here.
choice BOOTLOADER
	default BOOTLOADER_NONE if BOARD_ESP32C6_DEVKITC
	default BOOTLOADER_MCUBOOT if SOC_SERIES_NRF91
endchoice

if BOOTLOADER_MCUBOOT

choice BOOT_SIGNATURE_TYPE
	default BOOT_SIGNATURE_TYPE_ECDSA_P256
endchoice

endif

source "share/sysbuild/Kconfig"
```

## prj.conf
```kconfig
# CoAP over TLS/TCP (RFC 8323, coaps+tcp://), authenticated by a pre-shared
# key. The endpoint and the key belong in the git-ignored prj.local.conf.
CONFIG_PIGEON=y
CONFIG_PIGEON_CONNECTOR_COAP=y
CONFIG_PIGEON_COAP_TRANSPORT_TCP=y
# The modem's credential store outlives a reflash and is keyed by tag, so each
# sample here owns a distinct one rather than the shared default.
CONFIG_PIGEON_COAP_SEC_TAG=46

CONFIG_PICOLIBC=y
CONFIG_STD_C17=y
CONFIG_MISRA_SANE=y
CONFIG_SIZE_OPTIMIZATIONS=y

CONFIG_HEAP_MEM_POOL_SIZE=8192
CONFIG_MAIN_STACK_SIZE=8192
CONFIG_SYSTEM_WORKQUEUE_STACK_SIZE=4096
# Logging from the connection manager's event callbacks overflows the default.
CONFIG_NET_MGMT_EVENT_STACK_SIZE=2048

CONFIG_NETWORKING=y
CONFIG_NET_SOCKETS=y
CONFIG_NET_SOCKETS_SOCKOPT_TLS=y
CONFIG_NET_IPV4=y
CONFIG_NET_IPV6=y
CONFIG_NET_CONNECTION_MANAGER=y
CONFIG_NET_CONNECTION_MANAGER_MONITOR_STACK_SIZE=1024

CONFIG_LOG=y
CONFIG_LOG_DEFAULT_LEVEL=3
CONFIG_LOG_MODE_IMMEDIATE=y
# Lets the shadow's "log" field silence and restore logging at runtime.
CONFIG_LOG_RUNTIME_FILTERING=y
CONFIG_NET_LOG=y
CONFIG_NET_SOCKETS_LOG_LEVEL_DBG=y
```

## boards/circuitdojo_feather_nrf9160_ns.conf
```kconfig
# NCS boot banner
CONFIG_NCS_APPLICATION_BOOT_BANNER_STRING="Pigeon"

# Align the max FD entry to NRF_MODEM_MAX_SOCKET_COUNT(8) -- see https_init's
# board conf, same reasoning applies to any modem-offloaded socket use.
CONFIG_ZVFS_OPEN_MAX=8
CONFIG_NET_SOCKETS_POLL_MAX=8

# Disable Duplicate Address Detection (DAD)
# due to not being properly implemented for offloaded interfaces.
CONFIG_NET_IPV6_NBR_CACHE=n
CONFIG_NET_IPV6_MLD=n

# Connection Manager and Connectivity layer
CONFIG_NRF_MODEM_LIB_NET_IF=y

# Without this, connection_manager.c's lte_disconnect() calling
# conn_mgr_all_if_down() fully shuts down the modem library instead of just
# deactivating LTE, leaving lte_lc_power_off()'s subsequent CFUN=0 with no AT
# channel to succeed on -- see https_init's prj.conf for the full writeup;
# this sample shares the same connection_manager.c pattern.
CONFIG_NRF_MODEM_LIB_NET_IF_DOWN_DEFAULT_LTE_DISCONNECT=y

# AT Host
CONFIG_UART_INTERRUPT_DRIVEN=y
CONFIG_AT_HOST_LIBRARY=y

# CONFIG_MODEM_KEY_MGMT: nRF91 TLS sockets are offloaded to the modem,
# which resolves sec_tags against its OWN credential store --
# tls_credential_add() into Zephyr's native store is invisible there. This
# switches pigeon's PSK registration to modem_key_mgmt_write() (%CMNG types
# IDENTITY/PSK, hex-encoded secret), done eagerly at pigeon_init() time
# because the store only accepts writes while the modem is offline -- which
# is why this sample's main.c calls pigeon_init() BEFORE lte_connect().
CONFIG_MODEM_KEY_MGMT=y

# TF-M configurations
CONFIG_BUILD_WITH_TFM=y
CONFIG_TFM_PROFILE_TYPE_NOT_SET=y
CONFIG_TFM_CMAKE_BUILD_TYPE_RELEASE=y

# UART configuration (common)
CONFIG_SERIAL=y
CONFIG_UART_ASYNC_API=y

# UART configuration (nRF91 specific)
CONFIG_UART_1_ASYNC=y
CONFIG_UART_1_INTERRUPT_DRIVEN=n
```

## boards/esp32c6_devkitc_hpcore.conf
```kconfig
# Beyond ../../common/boards/esp32c6.conf.

# The connector authenticates with a pre-shared key, so mbedTLS needs a PSK key
# exchange; without one the TLS socket rejects the sec_tag at setsockopt().
CONFIG_MBEDTLS_KEY_EXCHANGE_PSK_ENABLED=y
# No ciphersuite is pinned, so mbedTLS offers everything these wants allow:
# AES-128-GCM and the constrained-device AES-128-CCM-8, both of which the
# platform's CoAP terminator accepts.
CONFIG_PSA_WANT_ALG_TLS12_PSK_TO_MS=y
CONFIG_PSA_WANT_ALG_SHA_256=y
CONFIG_PSA_WANT_ALG_CCM=y
CONFIG_PSA_WANT_ALG_GCM=y
CONFIG_PSA_WANT_KEY_TYPE_AES=y
# The key is imported into PSA as a derive key and run through the TLS 1.2 PRF;
# a missing want fails the import before a byte leaves the device.
CONFIG_PSA_WANT_KEY_TYPE_DERIVE=y
CONFIG_PSA_WANT_ALG_TLS12_PRF=y
CONFIG_PSA_WANT_ALG_HMAC=y
CONFIG_PSA_WANT_KEY_TYPE_HMAC=y
```

## boards/native_sim_native_64.conf
```kconfig
#
# Copyright (c) 2024 Nordic Semiconductor ASA
#
# SPDX-License-Identifier: LicenseRef-Nordic-5-Clause
#

# Native Simulator offloaded sockets (NSOS), not the TAP/zeth ethernet
# driver: TAP needs net-tools' net-setup.sh run as root (creates a host
# TAP interface, needs NAT to reach anything off-host) -- offloaded
# sockets instead call straight into the host's real BSD socket API
# (socket()/connect()/send()/...), so DNS resolution and routing are
# just whatever this machine's own network stack already does, with zero
# net-setup.sh/root/NAT step required. Modeled on upstream Zephyr's own
# samples/net/sockets/http_get/overlay-nsos.conf (its
# sample.net.sockets.http_get.nsos.https test config is the same NSOS +
# software-TLS combination this file builds, just against a different
# app). CONNECTIVITY_SIM is the piece that makes conn_mgr_all_if_up()/
# _connect() (this sample's connection_manager.c, shared with https_init)
# actually transition through NET_EVENT_L4_CONNECTED the same way a real
# interface would -- without it there's no net_if for conn_mgr to drive.
CONFIG_NETWORKING=y
CONFIG_NET_CONNECTION_MANAGER=y
CONFIG_NET_IPV4=y
CONFIG_NET_IPV6=y
CONFIG_POSIX_API=y

CONFIG_ETH_NATIVE_TAP=n
CONFIG_NET_DRIVERS=y
CONFIG_NET_SOCKETS=y
CONFIG_NET_SOCKETS_OFFLOAD=y
CONFIG_NET_NATIVE_OFFLOADED_SOCKETS=y
CONFIG_NET_NATIVE_OFFLOADED_SOCKETS_CONNECTIVITY_SIM=y

# TLS networking
CONFIG_NET_SOCKETS_ENABLE_DTLS=n
CONFIG_NET_SOCKETS_TLS_MAX_CONTEXTS=2
CONFIG_NET_SOCKETS_SOCKOPT_TLS=y

# TLS configuration
CONFIG_MBEDTLS=y
CONFIG_MBEDTLS_ENABLE_HEAP=y
CONFIG_MBEDTLS_HEAP_SIZE=40000
CONFIG_MBEDTLS_SSL_MAX_CONTENT_LEN=7168
CONFIG_MBEDTLS_PEM_PARSE_C=y
CONFIG_MBEDTLS_PEM_WRITE_C=y
CONFIG_MBEDTLS_CIPHERSUITE_TLS_ECDHE_RSA_WITH_AES_128_CBC_SHA256=y
CONFIG_MBEDTLS_CIPHERSUITE_TLS_ECDHE_ECDSA_WITH_AES_256_GCM_SHA384=y
CONFIG_MBEDTLS_SSL_SERVER_NAME_INDICATION=y
CONFIG_PSA_WANT_ECC_SECP_R1_384=y

# This sample's connector is PSK-based (pigeon_coap.c registers
# tls_psk_identity/tls_psk_secret as TLS credentials, not a CA cert) --
# without a PSK ciphersuite, sockets_tls.c rejects the sec_tag at
# setsockopt() time ("TLS with PSK disabled. Reconfigure mbed TLS to
# support PSK based key exchange."), found by actually running this
# native_sim/NSOS build against the real backend, not guessed.
CONFIG_MBEDTLS_CIPHERSUITE_TLS_PSK_WITH_AES_128_GCM_SHA256=y
CONFIG_PSA_WANT_ALG_SHA_256=y
CONFIG_PSA_WANT_ALG_GCM=y
CONFIG_PSA_WANT_KEY_TYPE_AES=y
```

## src/main.c
```c
#include <pigeon.h>
#include <zephyr/kernel.h>

#include "net_connect.h"
#include "shadow.h"

/* A Kconfig string is always defined, so "" is its only way of saying "not
 * supplied"; pigeon_init() reads a non-NULL empty string as a zero-length
 * credential that fails every handshake. */
#define PSK_CONF_OR_NULL(s) ((s)[0] ? (s) : NULL)

int main(void) {
  /* The pre-shared key is this device's whole authentication: the platform
   * maps the identity to a pigeon and keeps that pigeon's bearer token, so no
   * token is compiled in here. device_id only names the device in its own
   * logs. */
  struct pigeon_config config = {
      .device_id = "pigeon-coap-tcp-sample",
      .connector =
          {
              .type = PIGEON_CONNECTOR_COAP,
              .coap =
                  {
                      .tls_psk_identity = PSK_CONF_OR_NULL(CONFIG_PIGEON_COAP_TLS_PSK_IDENTITY),
                      .tls_psk_secret = PSK_CONF_OR_NULL(CONFIG_PIGEON_COAP_TLS_PSK_SECRET),
                  },
          },
  };

  int err = net_prepare();

  if (err) {
    return err;
  }

  /* Registers the PSK, so it runs before the interface comes up: a modem's
   * credential store only accepts writes while it is offline. */
  err = pigeon_init(&config);
  if (err) {
    return err;
  }

  err = net_connect();
  if (err) {
    return err;
  }

  shadow_loop();

  return net_disconnect();
}
```

## src/shadow.c
```c
/** @headerfile shadow.h */
#include "shadow.h"

#include <pigeon.h>
#include <string.h>
#include <zephyr/data/json.h>
#include <zephyr/kernel.h>
#include <zephyr/logging/log.h>
#include <zephyr/logging/log_ctrl.h>
#include <zephyr/sys/printk.h>

#include "net_connect.h"

LOG_MODULE_REGISTER(shadow);

/* target_config is opaque JSON to the library; this application decides what
 * its keys mean. */
struct app_shadow_config {
  bool log;
  int telemetry_interval;
  bool reboot;
};

static const struct json_obj_descr app_shadow_config_descr[] = {
    JSON_OBJ_DESCR_PRIM(struct app_shadow_config, log, JSON_TOK_TRUE),
    JSON_OBJ_DESCR_PRIM(struct app_shadow_config, telemetry_interval, JSON_TOK_NUMBER),
    JSON_OBJ_DESCR_PRIM(struct app_shadow_config, reboot, JSON_TOK_TRUE),
};

/* Defaults applied before the first sync of a boot. Nothing persists across
 * reboots, so every boot re-applies the platform's target from here. */
static struct app_shadow_config current_config = {
    .log = false,
    .telemetry_interval = 60,
    .reboot = false,
};

/* One call covers every module, so the shadow's "log" field really silences
 * and restores output. */
static void set_all_log_levels(uint32_t level) {
  uint32_t module_count = log_src_cnt_get(Z_LOG_LOCAL_DOMAIN_ID);

  for (uint32_t i = 0; i < module_count; i++) {
    log_filter_set(NULL, Z_LOG_LOCAL_DOMAIN_ID, (int16_t)i, level);
  }
}

/* Both keys ride one telemetry exchange. poll_count restarting at 1 doubles
 * as a reboot indicator on the dashboard. */
static void report_telemetry(void) {
  static unsigned int poll_count;
  char buf[21];

  snprintk(buf, sizeof(buf), "%lld", (long long)(k_uptime_get() / 1000));

  int err = pigeon_telemetry_set("uptime_s", buf);

  snprintk(buf, sizeof(buf), "%u", ++poll_count);

  if (!err) {
    err = pigeon_telemetry_set("poll_count", buf);
  }

  if (!err) {
    err = pigeon_telemetry_flush();
  }

  if (err) {
    LOG_WRN("Telemetry report failed: %d", err);
  }
}

int shadow_sync(void) {
  struct pigeon_shadow_doc doc;
  int err = pigeon_shadow_get(&doc);

  if (err) {
    LOG_ERR("Failed to fetch device shadow: %d", err);
    return err;
  }

  LOG_INF(
      "Shadow fetched: target_version=%d current_version=%d updated_at=%lld", doc.target_version,
      doc.current_version, doc.updated_at
  );

  report_telemetry();

  if (doc.target_version == doc.current_version) {
    LOG_INF("Shadow already converged at version %d; nothing to apply", doc.current_version);
    return 0;
  }

  /* json_obj_parse() edits its input, and target_config only lives until the
   * next fetch. Sized to the library's own config limit. */
  char config_buf[320];

  strncpy(config_buf, doc.target_config, sizeof(config_buf) - 1);
  config_buf[sizeof(config_buf) - 1] = '\0';

  /* Keys absent from a partial update keep their current value. reboot is a
   * one-shot command and always starts false. */
  struct app_shadow_config target = current_config;
  target.reboot = false;

  int64_t decoded = json_obj_parse(
      config_buf, strlen(config_buf), app_shadow_config_descr, ARRAY_SIZE(app_shadow_config_descr),
      &target
  );

  if (decoded < 0) {
    LOG_ERR("Failed to parse shadow target_config '%s': %lld", doc.target_config, decoded);
    return (int)decoded;
  }

  if (target.log != current_config.log) {
    LOG_INF(
        "Shadow v%d: log %s -> %s", doc.target_version, current_config.log ? "true" : "false",
        target.log ? "true" : "false"
    );
    set_all_log_levels(target.log ? CONFIG_LOG_DEFAULT_LEVEL : LOG_LEVEL_NONE);
  }

  if (target.telemetry_interval != current_config.telemetry_interval) {
    LOG_INF(
        "Shadow v%d: telemetry_interval %d -> %d", doc.target_version,
        current_config.telemetry_interval, target.telemetry_interval
    );
  }

  current_config.log = target.log;
  current_config.telemetry_interval = target.telemetry_interval;

  LOG_INF(
      "Applied shadow v%d: log=%s telemetry_interval=%d", doc.target_version,
      current_config.log ? "true" : "false", current_config.telemetry_interval
  );

  /* current_version is whatever this device reports, so the report goes out
   * even if a newer target is already pending by the time it lands. */
  char report_buf[128];
  int encode_err = json_obj_encode_buf(
      app_shadow_config_descr, ARRAY_SIZE(app_shadow_config_descr), &current_config, report_buf,
      sizeof(report_buf)
  );

  if (encode_err) {
    LOG_ERR("Failed to encode current_config for shadow report: %d", encode_err);
  } else {
    int report_err = pigeon_shadow_report(doc.target_version, report_buf);

    if (report_err) {
      LOG_WRN("Shadow report-back failed: %d", report_err);
    } else {
      LOG_INF("Reported current_config back to platform at v%d", doc.target_version);
    }
  }

  /* "reboot" is a command, not state: kept out of current_config so it is
   * never seen as unchanged and re-run on every poll. net_disconnect() comes
   * first because a modem reset without a graceful power-off trips its
   * reset-loop protection. */
  if (target.reboot) {
    LOG_WRN("Shadow v%d requested reboot; disconnecting and rebooting now", doc.target_version);
    net_disconnect();
    pigeon_reboot();
  }

  return 0;
}

void shadow_loop(void) {
  while (1) {
    shadow_sync();

    LOG_INF("Next shadow poll in %d s", current_config.telemetry_interval);
    k_sleep(K_SECONDS(current_config.telemetry_interval));
  }
}
```

## src/shadow.h
```c
/** @file shadow.h
 *  @brief Fetches the device shadow from the platform and applies it locally.
 */
#ifndef SHADOW_H
#define SHADOW_H

/** @fn int shadow_sync(void)
 *  @brief Fetch the device shadow, apply target_config if the platform has
 *  moved to a newer version than what's already applied this boot, and log
 *  what changed.
 *  @return 0 on success (whether or not an update was applied), negative
 *  error code on transport/parse failure.
 */
int shadow_sync(void);

/** @fn void shadow_loop(void)
 *  @brief Repeatedly shadow_sync(), sleeping the shadow's own
 *  telemetry_interval (seconds) between polls -- config polling during
 *  what would be a telemetry publish window, once telemetry publishing
 *  exists (see pigeon's CLAUDE.md notes on missing backend endpoints).
 *  Never returns under normal operation.
 */
void shadow_loop(void);

#endif
```
