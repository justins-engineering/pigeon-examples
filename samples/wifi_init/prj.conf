## CMakeLists.txt
```
cmake_minimum_required(VERSION 3.20.0)

# This sample verifies the platform's certificate chain.
set(SAMPLE_TLS verify)
include(${CMAKE_CURRENT_SOURCE_DIR}/../common/app.cmake)

find_package(Zephyr REQUIRED HINTS $ENV{ZEPHYR_BASE})
project(wifi_init)

include(${CMAKE_CURRENT_SOURCE_DIR}/../common/cert.cmake)

target_sources(app PRIVATE src/main.c src/shadow.c)

include(${CMAKE_CURRENT_SOURCE_DIR}/../common/net.cmake)
```

## sysbuild.conf
```
# Espressif boards default the sysbuild bootloader choice to MCUboot. The
# default build here is a single image anyone can flash without a signing key
# or a slot layout to match; sysbuild-mcuboot.conf turns MCUboot back on for a
# firmware-update build.
SB_CONFIG_BOOTLOADER_NONE=y
```

## prj.conf
```kconfig
# HTTPS connector over whichever network the board brings up. The endpoint and
# token belong in the git-ignored prj.local.conf. Firmware updates are opt-in:
# see fota.conf.
CONFIG_PIGEON=y
CONFIG_PIGEON_CONNECTOR_HTTPS=y
# The modem's credential store outlives a reflash and is keyed by tag, so each
# sample here owns a distinct one rather than the shared default.
CONFIG_PIGEON_HTTPS_SEC_TAG=49

CONFIG_BOOT_BANNER_STRING="Pigeon"

CONFIG_PICOLIBC=y
CONFIG_STD_C17=y
CONFIG_MISRA_SANE=y
CONFIG_DEBUG=y

CONFIG_HEAP_MEM_POOL_SIZE=8192
CONFIG_MAIN_STACK_SIZE=8192
CONFIG_SYSTEM_WORKQUEUE_STACK_SIZE=4096
# Logging from the connection manager's event callbacks overflows the default.
CONFIG_NET_MGMT_EVENT_STACK_SIZE=2048

CONFIG_NETWORKING=y
CONFIG_NET_SOCKETS=y
CONFIG_NET_SOCKETS_SOCKOPT_TLS=y
CONFIG_NET_IPV4=y
CONFIG_NET_IPV6=y
CONFIG_NET_CONNECTION_MANAGER=y
CONFIG_NET_CONNECTION_MANAGER_MONITOR_STACK_SIZE=1024

CONFIG_LOG=y
CONFIG_LOG_DEFAULT_LEVEL=3
CONFIG_LOG_MODE_IMMEDIATE=y
# Lets the shadow's "log" field silence and restore logging at runtime.
CONFIG_LOG_RUNTIME_FILTERING=y
CONFIG_NET_LOG=y
CONFIG_NET_SOCKETS_LOG_LEVEL_DBG=y
```

## fota.conf
```kconfig
# Firmware updates for this sample, merged on top of prj.conf; the README has
# the command. Both its conf paths resolve against this directory, not the one
# west runs in. Kept out of prj.conf so the default build stays a single image
# with no bootloader: an image signed for a slot layout the board is not
# running is worse than no update path at all. sysbuild-mcuboot.conf is the
# other half.

# The write path into MCUboot's second slot. Download resume and the attempt
# budget persist through settings over NVS; without that backend both start
# over on every boot.
CONFIG_BOOTLOADER_MCUBOOT=y
CONFIG_FLASH=y
CONFIG_FLASH_MAP=y
CONFIG_STREAM_FLASH=y
CONFIG_IMG_MANAGER=y
CONFIG_MCUBOOT_IMG_MANAGER=y
CONFIG_NVS=y
CONFIG_SETTINGS=y
CONFIG_SETTINGS_NVS=y

CONFIG_PIGEON_FOTA=y
CONFIG_PIGEON_FOTA_RESUME=y
# One shadow target is chased a bounded number of times, so an image that
# boot-loops cannot re-download itself forever. Writing the shadow anew
# advances target_version, which reopens the budget.
CONFIG_PIGEON_FOTA_ATTEMPT_BUDGET=y

# Compared byte for byte against the shadow's firmware.version and never read
# from MCUboot's image header, so it has to name whatever version this image is
# uploaded under. The placeholder announces itself the first time a shadow
# offers a real version.
CONFIG_PIGEON_FOTA_CURRENT_VERSION="0.0.0-unversioned"

# One TLS connection per Range chunk costs about nine seconds here; 32 KiB
# chunks fetch an 800 KiB image in about 25 of them.
CONFIG_PIGEON_FOTA_CHUNK_SIZE=32768

# A long download can still fail a WiFi-adapter allocation inside a fatal
# ESP_ERROR_CHECK; a reboot there resumes from the persisted offset.
CONFIG_PIGEON_REBOOT_ON_FATAL=y
```

## sysbuild-mcuboot.conf
```kconfig
# The other half of fota.conf: puts MCUboot back under this sample without
# changing what the default build does.
#
# The board's partition table already carries boot/slot0/slot1 and a storage
# partition for the settings backend, and upstream Zephyr builds MCUboot's
# ESP32-C6 port, so nothing else is needed here.
SB_CONFIG_BOOTLOADER_MCUBOOT=y

# The board defaults this choice to a hash with no signature at all. Which key
# signs the image is ../mcuboot-signing.cmake's business.
SB_CONFIG_BOOT_SIGNATURE_TYPE_ECDSA_P256=y
```

## boards/esp32c6_devkitc_hpcore.conf
```kconfig
# Beyond ../../common/boards/esp32c6.conf.

# Verifying the platform's certificate chain in mbedTLS.
CONFIG_MBEDTLS_X509_CRT_PARSE_C=y
# The CA ships as PEM; without this mbedTLS accepts only DER.
CONFIG_MBEDTLS_PEM_PARSE_C=y
# Without SNI the edge answers the ClientHello with handshake_failure.
CONFIG_MBEDTLS_SSL_SERVER_NAME_INDICATION=y
CONFIG_MBEDTLS_KEY_EXCHANGE_ECDHE_RSA_ENABLED=y
CONFIG_MBEDTLS_KEY_EXCHANGE_ECDHE_ECDSA_ENABLED=y
CONFIG_PSA_WANT_ALG_ECDH=y
CONFIG_PSA_WANT_ALG_ECDSA=y
CONFIG_PSA_WANT_ALG_RSA_PKCS1V15_SIGN=y
CONFIG_PSA_WANT_ALG_SHA_256=y
# The root is P-384 and signs with SHA-384; the leaf is P-256.
CONFIG_PSA_WANT_ALG_SHA_384=y
CONFIG_PSA_WANT_ECC_SECP_R1_256=y
CONFIG_PSA_WANT_ECC_SECP_R1_384=y
CONFIG_PSA_WANT_KEY_TYPE_ECC_PUBLIC_KEY=y
CONFIG_PSA_WANT_KEY_TYPE_ECC_KEY_PAIR_IMPORT=y
# ECDHE generates a fresh key pair per handshake, a separate PSA want.
CONFIG_PSA_WANT_KEY_TYPE_ECC_KEY_PAIR_GENERATE=y
CONFIG_PSA_WANT_KEY_TYPE_RSA_PUBLIC_KEY=y
# ECDHE-RSA depends on an RSA key-pair want even for a verify-only client.
CONFIG_PSA_WANT_KEY_TYPE_RSA_KEY_PAIR_IMPORT=y
CONFIG_PSA_WANT_ALG_GCM=y
CONFIG_PSA_WANT_KEY_TYPE_AES=y
# TLS 1.2 derives the master secret with its own PSA algorithm.
CONFIG_PSA_WANT_ALG_TLS12_PRF=y
CONFIG_PSA_WANT_ALG_HMAC=y
CONFIG_PSA_WANT_KEY_TYPE_HMAC=y
```

## boards/native_sim_native_64.conf
```kconfig
# native_sim has no ESP32-C6 WiFi radio -- src/net/native_sim_connection_manager.c
# (selected by CMakeLists.txt for this board) swaps the real WiFi bring-up
# for a generic conn_mgr flow over Native Simulator offloaded sockets
# (NSOS), same rationale as coap_tcp_init's native_sim board conf: NSOS
# calls straight into the host's own BSD socket API, so DNS/routing/connect
# just use whatever this machine's network stack already does -- no
# net-setup.sh/root/TAP/NAT step needed at all. pigeon's HTTPS transport
# code, and every TLS/PSA fix below this file's own additions (still
# supplied by prj.conf, unchanged), are exactly what real ESP32-C6 hardware
# needed too -- this file only swaps out the network *bring-up*, the point
# of a native_sim variant being to exercise the platform protocol, not WiFi.

# CONFIG_WIFI is a plain bool (no board-forced default the way
# ETH_NATIVE_TAP is), so overriding it here is a normal .conf override, not
# a Kconfig "select" fight. WIFI_CREDENTIALS/_STATIC have no "depends on
# WIFI" of their own, but are disabled anyway since this board never reads
# them; ESP32_WIFI_DYNAMIC_RX_BUFFER_NUM lives under WIFI_ESP32's own
# Kconfig.esp32, unreachable once CONFIG_WIFI=n, so it's dropped rather than
# assigned to avoid an unsatisfied-dependency warning (fatal under this
# workspace's west-vanilla.yml build, task #8).
CONFIG_WIFI=n
CONFIG_WIFI_CREDENTIALS=n
CONFIG_WIFI_CREDENTIALS_STATIC=n

# No DHCP client either -- native_sim_connection_manager.c assigns a fixed
# dummy address itself (see its own comment for why conn_mgr needs one at
# all with NSOS's connectivity-sim interface).
CONFIG_NET_DHCPV4=n

CONFIG_ETH_NATIVE_TAP=n
CONFIG_NET_DRIVERS=y
CONFIG_NET_SOCKETS_OFFLOAD=y
CONFIG_NET_NATIVE_OFFLOADED_SOCKETS=y
CONFIG_NET_NATIVE_OFFLOADED_SOCKETS_CONNECTIVITY_SIM=y
```

## src/main.c
```c
#include <pigeon.h>
#include <zephyr/kernel.h>

#include "net_connect.h"
#include "shadow.h"

/* The platform's root CA, terminated because mbedTLS parses PEM as a string. */
static const char ca_cert[] = {
#include "GTS_Root_R4.crt.hex"
    0x00
};

int main(void) {
  int err = net_prepare();

  if (err) {
    return err;
  }

  err = net_install_ca(CONFIG_PIGEON_HTTPS_SEC_TAG, ca_cert, sizeof(ca_cert));
  if (err) {
    return err;
  }

  err = net_connect();
  if (err) {
    return err;
  }

  /* The endpoint and token come from Kconfig. device_id only names this
   * device in its own logs; the platform identifies it by its token. */
  struct pigeon_config config = {
      .device_id = "pigeon-wifi-sample",
      .connector = {.type = PIGEON_CONNECTOR_HTTPS},
  };

  err = pigeon_init(&config);
  if (err) {
    net_disconnect();
    return err;
  }

  shadow_loop();

  return net_disconnect();
}
```

## src/shadow.c
```c
/** @headerfile shadow.h */
#include "shadow.h"

#include <pigeon.h>
#include <string.h>
#include <zephyr/data/json.h>
#include <zephyr/kernel.h>
#include <zephyr/logging/log.h>
#include <zephyr/logging/log_ctrl.h>
#include <zephyr/sys/printk.h>

#include "net_connect.h"

LOG_MODULE_REGISTER(shadow);

/* target_config is opaque JSON to the library; this application decides what
 * its keys mean. "firmware" decodes into the struct pigeon_fota_apply() takes. */
struct app_shadow_config {
  bool log;
  int telemetry_interval;
  bool reboot;
#if defined(CONFIG_PIGEON_FOTA)
  struct pigeon_fota_info firmware;
#endif
};

#if defined(CONFIG_PIGEON_FOTA)
static const struct json_obj_descr app_firmware_descr[] = {
    JSON_OBJ_DESCR_PRIM(struct pigeon_fota_info, version, JSON_TOK_STRING_BUF),
    JSON_OBJ_DESCR_PRIM(struct pigeon_fota_info, size, JSON_TOK_NUMBER),
    JSON_OBJ_DESCR_PRIM(struct pigeon_fota_info, sha256, JSON_TOK_STRING_BUF),
};
#endif

static const struct json_obj_descr app_shadow_config_descr[] = {
    JSON_OBJ_DESCR_PRIM(struct app_shadow_config, log, JSON_TOK_TRUE),
    JSON_OBJ_DESCR_PRIM(struct app_shadow_config, telemetry_interval, JSON_TOK_NUMBER),
    JSON_OBJ_DESCR_PRIM(struct app_shadow_config, reboot, JSON_TOK_TRUE),
#if defined(CONFIG_PIGEON_FOTA)
    JSON_OBJ_DESCR_OBJECT(struct app_shadow_config, firmware, app_firmware_descr),
#endif
};

/* Defaults applied before the first sync of a boot. Nothing persists across
 * reboots, so every boot re-applies the platform's target from here.
 * firmware.version starts at this build's own version, which is what lets a
 * freshly booted image report itself as converged with no bookkeeping. */
static struct app_shadow_config current_config = {
    .log = false,
    .telemetry_interval = 60,
    .reboot = false,
#if defined(CONFIG_PIGEON_FOTA)
    .firmware = {.version = CONFIG_PIGEON_FOTA_CURRENT_VERSION, .size = 0, .sha256 = ""},
#endif
};

/* One call covers every module, so the shadow's "log" field really silences
 * and restores output. */
static void set_all_log_levels(uint32_t level) {
  uint32_t module_count = log_src_cnt_get(Z_LOG_LOCAL_DOMAIN_ID);

  for (uint32_t i = 0; i < module_count; i++) {
    log_filter_set(NULL, Z_LOG_LOCAL_DOMAIN_ID, (int16_t)i, level);
  }
}

/* Both keys ride one telemetry POST. poll_count restarting at 1 doubles as a
 * reboot indicator on the dashboard. */
static void report_telemetry(void) {
  static unsigned int poll_count;
  char buf[21];

  snprintk(buf, sizeof(buf), "%lld", (long long)(k_uptime_get() / 1000));

  int err = pigeon_telemetry_set("uptime_s", buf);

  snprintk(buf, sizeof(buf), "%u", ++poll_count);

  if (!err) {
    err = pigeon_telemetry_set("poll_count", buf);
  }

  if (!err) {
    err = pigeon_telemetry_flush();
  }

  if (err) {
    LOG_WRN("Telemetry report failed: %d", err);
  }
}

int shadow_sync(void) {
  struct pigeon_shadow_doc doc;
  int err = pigeon_shadow_get(&doc);

  if (err) {
    LOG_ERR("Failed to fetch device shadow: %d", err);
    return err;
  }

  LOG_INF(
      "Shadow fetched: target_version=%d current_version=%d updated_at=%lld", doc.target_version,
      doc.current_version, doc.updated_at
  );

#if defined(CONFIG_PIGEON_FOTA)
  /* A successful fetch is this application's definition of a healthy boot.
   * Runs before the convergence check so a new image that lands already
   * converged is still confirmed; a no-op once confirmed. */
  pigeon_fota_confirm_boot();
#endif

  report_telemetry();

  if (doc.target_version == doc.current_version) {
    LOG_INF("Shadow already converged at version %d; nothing to apply", doc.current_version);
    return 0;
  }

  /* json_obj_parse() edits its input, and target_config only lives until the
   * next fetch. */
  char config_buf[CONFIG_PIGEON_SHADOW_CONFIG_MAX];

  strncpy(config_buf, doc.target_config, sizeof(config_buf) - 1);
  config_buf[sizeof(config_buf) - 1] = '\0';

  /* Keys absent from a partial update keep their current value. reboot is a
   * one-shot command and always starts false. */
  struct app_shadow_config target = current_config;
  target.reboot = false;

  int64_t decoded = json_obj_parse(
      config_buf, strlen(config_buf), app_shadow_config_descr, ARRAY_SIZE(app_shadow_config_descr),
      &target
  );

  if (decoded < 0) {
    LOG_ERR("Failed to parse shadow target_config '%s': %lld", doc.target_config, decoded);
    return (int)decoded;
  }

  if (target.log != current_config.log) {
    LOG_INF(
        "Shadow v%d: log %s -> %s", doc.target_version, current_config.log ? "true" : "false",
        target.log ? "true" : "false"
    );
    set_all_log_levels(target.log ? CONFIG_LOG_DEFAULT_LEVEL : LOG_LEVEL_NONE);
  }

  if (target.telemetry_interval != current_config.telemetry_interval) {
    LOG_INF(
        "Shadow v%d: telemetry_interval %d -> %d", doc.target_version,
        current_config.telemetry_interval, target.telemetry_interval
    );
  }

  current_config.log = target.log;
  current_config.telemetry_interval = target.telemetry_interval;

  LOG_INF(
      "Applied shadow v%d: log=%s telemetry_interval=%d", doc.target_version,
      current_config.log ? "true" : "false", current_config.telemetry_interval
  );

#if defined(CONFIG_PIGEON_FOTA)
  /* The library compares against this build's compiled-in version, not
   * current_config, so a "firmware" key absent from the update is a no-op. */
  bool firmware_applied = false;
  /* Set when the shadow named an image this poll did not end up running.
   * Convergence is what makes the next poll return early, so reporting it
   * would leave the platform showing converged while the device stays on the
   * old image and stops trying. */
  bool firmware_unconverged = false;

  if (!pigeon_fota_update_available(&target.firmware)) {
    /* Running what is offered, so release any budget still held against it and
     * let a later re-offer of the same version start full. */
    pigeon_fota_attempts_clear();
  } else if (!pigeon_fota_attempt_allowed(&target.firmware, doc.target_version)) {
    LOG_ERR(
        "FOTA: attempt budget spent for firmware %s at shadow v%d; not downloading it again "
        "until the shadow is written anew",
        target.firmware.version, doc.target_version
    );
    target.firmware = current_config.firmware;
    firmware_unconverged = true;
  } else {
    LOG_WRN(
        "Shadow v%d requests firmware %s (currently running %s); starting FOTA download",
        doc.target_version, target.firmware.version, CONFIG_PIGEON_FOTA_CURRENT_VERSION
    );

    int fota_err = pigeon_fota_apply(&target.firmware);

    if (fota_err) {
      LOG_ERR(
          "FOTA apply failed: %d; leaving current image running, will retry next poll", fota_err
      );
      /* The report below has to name the version still running. */
      target.firmware = current_config.firmware;
      firmware_unconverged = true;
    } else {
      LOG_WRN("FOTA: image staged; rebooting to let the new image report for itself");
      /* A staged image is not a booted one: the bootloader can still refuse
       * it, and the image that boots reports its own version on its first
       * poll. The cost is one poll cycle before the platform sees convergence. */
      firmware_unconverged = true;
      firmware_applied = true;
    }
  }
#endif

  /* Sized for the firmware object too, whose sha256 alone is 64 characters. */
  char report_buf[256];
  int encode_err = json_obj_encode_buf(
      app_shadow_config_descr, ARRAY_SIZE(app_shadow_config_descr), &current_config, report_buf,
      sizeof(report_buf)
  );
  /* The report always carries what is running. Only the version it is
   * reported at is held back, which is what leaves the shadow short of its
   * target. */
  int32_t report_version = doc.target_version;

#if defined(CONFIG_PIGEON_FOTA)
  if (firmware_unconverged) {
    report_version = doc.current_version;
    if (firmware_applied) {
      LOG_WRN(
          "Shadow v%d left unconverged: reporting at v%d as firmware %s, the version still "
          "running; the image being booted into reports its own on its first poll",
          doc.target_version, report_version, current_config.firmware.version
      );
    } else {
      LOG_WRN(
          "Shadow v%d left unconverged: still running firmware %s, reporting at v%d so the next "
          "poll retries",
          doc.target_version, current_config.firmware.version, report_version
      );
    }
  }
#endif

  if (encode_err) {
    LOG_ERR("Failed to encode current_config for shadow report: %d", encode_err);
  } else {
    int report_err = pigeon_shadow_report(report_version, report_buf);

    if (report_err) {
      LOG_WRN("Shadow report-back failed: %d", report_err);
    } else {
      LOG_INF("Reported current_config back to platform at v%d", report_version);
    }
  }

#if defined(CONFIG_PIGEON_FOTA)
  if (target.reboot && firmware_unconverged) {
    /* Convergence is the only record that this one-shot command ran, and the
     * report above withheld it, so obeying now would reboot on every poll
     * until the firmware target resolves. A shadow carrying both reboots
     * twice: into the new image, then once more for the command. */
    LOG_WRN(
        "Shadow v%d requested reboot; deferring it until the firmware target resolves",
        doc.target_version
    );
    target.reboot = false;
  }
#endif

  /* "reboot" is a command, not state: kept out of current_config so it is
   * never seen as unchanged and re-run on every poll. Disconnecting first
   * leaves the access point without a stale association to time out. */
  if (target.reboot) {
    LOG_WRN("Shadow v%d requested reboot; disconnecting and rebooting now", doc.target_version);
    net_disconnect();
    pigeon_reboot();
  }

#if defined(CONFIG_PIGEON_FOTA)
  if (firmware_applied) {
    LOG_WRN(
        "FOTA: disconnecting and rebooting into newly staged firmware %s", target.firmware.version
    );
    net_disconnect();
    pigeon_reboot();
  }
#endif

  return 0;
}

void shadow_loop(void) {
  while (1) {
    shadow_sync();

    LOG_INF("Next shadow poll in %d s", current_config.telemetry_interval);
    k_sleep(K_SECONDS(current_config.telemetry_interval));
  }
}
```

## src/shadow.h
```c
/** @file shadow.h
 *  @brief Shadow sync: fetch, apply, report back, plus telemetry.
 */
#ifndef SHADOW_H
#define SHADOW_H

/** Fetches the shadow, applies a newer target_config and reports the result.
 *  Returns 0 whether or not anything changed, negative on a transport or
 *  parse failure. */
int shadow_sync(void);

/** Runs shadow_sync() forever, sleeping the shadow's own telemetry_interval
 *  between polls. */
void shadow_loop(void);

#endif
```
