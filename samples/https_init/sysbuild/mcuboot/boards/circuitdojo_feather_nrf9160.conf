## samples/https_init/sysbuild/mcuboot/boards/circuitdojo_feather_nrf9160.conf
```kconfig
# Core should be on a clean state when TF-M starts
CONFIG_MCUBOOT_CLEANUP_ARM_CORE=y

# Max image sectors is calculated automatically from the DTS partition/erase
# sizes now that Partition Manager is disabled (BOOT_MAX_IMG_SECTORS_AUTO
# defaults to y when !PARTITION_MANAGER_ENABLED); a manual value here would
# just be dead config.

# Multithreading
CONFIG_MULTITHREADING=y

# Enable flash operations
CONFIG_FLASH=y
CONFIG_FLASH_MAP=y
CONFIG_FLASH_PAGE_LAYOUT=y
CONFIG_STREAM_FLASH=y

# Enable serial recovery
CONFIG_SERIAL=y
CONFIG_MCUBOOT_SERIAL=y
CONFIG_MCUBOOT_INDICATION_LED=y
CONFIG_BOOT_SERIAL_UART=y
CONFIG_BOOT_SERIAL_DETECT_DELAY=450
CONFIG_MCUBOOT_SERIAL_DIRECT_IMAGE_UPLOAD=y
CONFIG_BOOT_SERIAL_WAIT_FOR_DFU=y
CONFIG_BOOT_SERIAL_WAIT_FOR_DFU_TIMEOUT=1000
CONFIG_BOOT_SERIAL_IMG_GRP_IMAGE_STATE=y

# Console
# MCUboot's serial_adapter.c hard-errors at build time if CONFIG_UART_CONSOLE
# is enabled alongside CONFIG_MCUBOOT_SERIAL: the recovery transport and the
# UART console driver can't both own uart0's RX path. So the console is routed
# to RTT instead of UART: this keeps newtmgr serial recovery (uart0 /
# /dev/ttyUSB0, see the "Load image via bootloader" .vscode task) working,
# while still giving MCUboot log output, viewable with a debug probe (J-Link
# RTT viewer, nrfjprog --rtt, etc).
#
# Note: with CONFIG_LOG_MODE_MINIMAL (see prj.conf), log calls route straight
# through printk() rather than the log_backend framework, so what matters here
# is CONFIG_RTT_CONSOLE (printk's output target), not CONFIG_LOG_BACKEND_RTT.
CONFIG_CONSOLE=y
CONFIG_UART_CONSOLE=n
CONFIG_USE_SEGGER_RTT=y
CONFIG_RTT_CONSOLE=y
# Block (rather than trim/skip) so MCUboot's brief run doesn't finish and
# overwrite the RTT buffer before a debugger/viewer has had a chance to
# attach and read it. Trade-off: boot stalls if nothing ever reads the RTT
# buffer, which is fine for bring-up/verification but worth revisiting for
# unattended production use.
CONFIG_SEGGER_RTT_MODE_BLOCK_IF_FIFO_FULL=y

# Logging
CONFIG_LOG=y
```
