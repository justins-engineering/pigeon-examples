/* No CTS/RTS pins are routed, and hardware flow control without CTS blocks
 * TX forever. */
&uart0 {
  status = "okay";
  compatible = "nordic,nrf-uarte";
  current-speed = <1000000>;
  pinctrl-0 = <&uart0_default>;
  pinctrl-1 = <&uart0_sleep>;
  pinctrl-names = "default", "sleep";
};

/ {
  chosen {
    /* MCUboot links against the boot partition, not the board's slot0
     * default. It has to be here: a board overlay replaces app.overlay. */
    zephyr,code-partition = &boot_partition;

    zephyr,uart-mcumgr = &uart0;
  };
};
